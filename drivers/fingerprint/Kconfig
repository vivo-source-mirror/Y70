## drivers/fingerprint/Kconfig
```kconfig
menu "BBK FINGERPRINT support"
config BBK_FINGERPRINT
	tristate "BBK FINGERPRINT support"
	help
	  Say Y here to enable switch class support. This allows
	  monitoring switches by userspace via sysfs and uevent.

if BBK_FINGERPRINT

config BBK_FP_ID
	tristate "BBK FP ID support"
	help
	  Say Y here to enable switch class support.

config BBK_FP_HBM_INPUT
	tristate "BBK FP HBM INPUT support"
	help
	  Say Y here to enable switch class support.
endif
source "drivers/fingerprint/gf3658/Kconfig"
source "drivers/fingerprint/gf9518/Kconfig"
source "drivers/fingerprint/fpc1511/Kconfig"
source "drivers/fingerprint/et713/Kconfig"
endmenu
```

## drivers/fingerprint/et713/Kconfig
```kconfig
config BBK_ET713
	tristate "Egis ET713 fingerprint drvier support"
	help
	  Say Y here to enable et713 fingerprint driver support!
```

## drivers/gpu/drm/msm/vivosrc/Kconfig
```kconfig
config DISPLAY_VIVO
	depends on DRM_MSM
	bool "mdss config for vivo product"
	default n
	---help---
	Mdss config signature for vivo product
```

## drivers/mmc/Kconfig
```kconfig
#
# MMC subsystem configuration
#

menuconfig MMC
	tristate "MMC/SD/SDIO card support"
	depends on HAS_IOMEM
	help
	  This selects MultiMediaCard, Secure Digital and Secure
	  Digital I/O support.

	  If you want MMC/SD/SDIO support, you should say Y here and
	  also to your specific host controller driver.

config MMC_PERF_PROFILING
	bool "MMC performance profiling"
	depends on MMC != n
	default n
	help
	  If you say Y here, support will be added for collecting
	  performance numbers at the MMC Queue and Host layers.

config MMC_IO_STATS
	bool "Enable statistics the mmc I/O options"
	depends on DEBUG_FS
	help
		Provide a method of statistics the mmc I/O options.

if MMC

source "drivers/mmc/core/Kconfig"

source "drivers/mmc/host/Kconfig"

endif # MMC
```

## drivers/power/supply/qcom/Kconfig
```kconfig
menu "Qualcomm Technologies, Inc. Charger and Fuel Gauge support"

config QPNP_FG_GEN3
	tristate "QPNP GEN3 fuel gauge driver"
	depends on MFD_SPMI_PMIC
	help
	  Say Y here to enable the GEN3 Fuel Gauge driver. This adds support
	  for battery fuel gauging and state of charge of battery connected to
	  the fuel gauge. The state of charge is reported through a BMS power
	  supply property and also sends uevents when the capacity is updated.

config QPNP_FG_GEN4
	tristate "QPNP GEN4 fuel gauge driver"
	depends on MFD_SPMI_PMIC
	help
	  Say Y here to enable the GEN4 Fuel Gauge driver. This adds support
	  for battery fuel gauging and state of charge of battery connected to
	  the device that has QTI PMICs like PM8150B. The state of charge is
	  reported through a BMS power supply property and also sends uevents
	  when the capacity is updated.

config QPNP_QG
	bool "QPNP Qgauge driver"
	depends on MFD_SPMI_PMIC
	help
	  Say Y here to enable the Qualcomm Technologies, Inc. QGauge driver
	  which uses the periodic sampling of the battery voltage and current
	  to determine the battery state-of-charge (SOC) and supports other
	  battery management features.

config SMB1351_USB_CHARGER
	tristate "smb1351 usb charger (with VBUS detection)"
	depends on I2C
	help
	 Say Y to enable support for the SMB1351 switching mode based charger.
	 The driver supports charging control (enable/disable) and
	 charge-current limiting. It also provides USB VBUS detection and
	 notification support. The driver controls SMB1351 via I2C and
	 supports device-tree interface.

config SMB1355_SLAVE_CHARGER
	tristate "SMB1355 Slave Battery Charger"
	depends on MFD_I2C_PMIC
	help
	  Say Y to include support for SMB1355 Battery Charger.
	  SMB1355 is a single phase 5A battery charger.
	  The driver supports charger enable/disable.
	  The driver reports the charger status via the power supply framework.
	  A charger status change triggers an IRQ via the device STAT pin.

config QPNP_SMB2
	tristate "SMB2 Battery Charger"
	depends on MFD_SPMI_PMIC
	help
	  Say Y to enables support for the SMB2 charging peripheral.
	  The QPNP SMB2 charger driver supports the charger peripheral
	  present in the PMICOBALT chip.
	  The power supply framework is used to communicate battery and
	  usb properties to userspace and other driver consumers such
	  as fuel gauge, USB, and USB-PD.
	  VBUS and VCONN regulators are registered for supporting OTG,
	  and powered Type-C cables respectively.

config QPNP_SMB5
	tristate "SMB5 Battery Charger"
	depends on MFD_SPMI_PMIC
	help
	  Say Y to enables support for the SMB5 charging peripheral.
	  The QPNP SMB5 charger driver supports the charger peripheral
	  present in the chip.
	  The power supply framework is used to communicate battery and
	  usb properties to userspace and other driver consumers such
	  as fuel gauge, USB, and USB-PD.
	  VBUS and VCONN regulators are registered for supporting OTG,
	  and powered Type-C cables respectively.

config BQ25890_SLAVE_CHARGER
     tristate "TI BQ2589x battery charger driver"
     depends on I2C
     help
       Say Y to enable support for the TI BQ2589x battery charger
       PMICs.

       You'll need this driver to charge batteries on e.g. Nokia
       RX-51/N900.

config STM32l011X4
	tristate "STM32l011X4 driver"
	depends on I2C
	default n
	help
		Say Y here to enable support for STM32l011X4.

config BATTERY_DETECT
	bool "battery protect"
	help
	  Say Y here to enable.

config BATTERY_BQ27546
	tristate "BQ27546 battery driver"
	depends on I2C
	help
	  Say Y here to enable support for batteries with BQ28Z61 (I2C) chips.
	  The BQ28Z61 Texas Instruments Inc device monitors the battery
	  charging/discharging status via Rsens resistor, typically 10 mohm.
	  It monitors the battery temperature via Thermistor.
	  The device monitors the battery level (Relative-State-Of-Charge).
	  The device is SBS compliant, providing battery info over I2C.

config SMB138X_CHARGER
	tristate "SMB138X Battery Charger"
	depends on MFD_I2C_PMIC
	help
	  Say Y to include support for SMB138X Battery Charger.
	  SMB1380 is a dual phase 6A battery charger, and SMB1381 is a single
	  phase 5A battery charger.
	  The driver supports charger enable/disable.
	  The driver reports the charger status via the power supply framework.
	  A charger status change triggers an IRQ via the device STAT pin.

config FUEL_SUMMARY
	tristate "VIVO FUEL SUMMARY"
	help
	  Say Y to enable support for the FUEL SUMMARY

config QPNP_QNOVO
	bool "QPNP QNOVO driver"
	depends on MFD_SPMI_PMIC
	help
	  Say Y here to enable the Qnovo pulse charging engine. Qnovo driver
	  accepts pulse parameters via sysfs entries and programs the hardware
	  module. It also allows userspace code to read diagnostics of voltage
	  and current measured during certain phases of the pulses.

config QPNP_QNOVO5
	bool "QPNP QNOVO5 driver"
	depends on MFD_SPMI_PMIC
	help
	  Say Y here to enable the Qnovo5 PBS-based pulse charging engine.
	  Qnovo5 driver accepts pulse parameters via sysfs entries and programs
	  the hardware module. It also allows userspace code to read diagnostics
	  of voltage and current measured during certain phases of the pulses.

config SMB1390_CHARGE_PUMP
	tristate "SMB1390 Charge Pump"
	depends on MFD_I2C_PMIC
	help
	  Say Y to include support for SMB1390 Charge Pump.
	  SMB1390 is a div2 charge pump capable of delivering 6A charge current
	  with very high efficiency.

config SMB1390_CHARGE_PUMP_PSY
	tristate "SMB1390 power supply framework based driver"
	depends on MFD_I2C_PMIC && !SMB1390_CHARGE_PUMP
	help
	  Say Y to include support for SMB1390 Charge Pump driver based on
	  power supply framework.
	  SMB1390 is a div2 charge pump capable of delivering 6A charge current
	  with very high efficiency.

endmenu
```
