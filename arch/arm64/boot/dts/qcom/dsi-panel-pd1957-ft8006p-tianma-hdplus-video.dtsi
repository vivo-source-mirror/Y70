/* Copyright (c) 2019, The Linux Foundation. All rights reserved.
 *
 * This program is free software; you can redistribute it and/or modify
 * it under the terms of the GNU General Public License version 2 and
 * only version 2 as published by the Free Software Foundation.
 *
 * This program is distributed in the hope that it will be useful,
 * but WITHOUT ANY WARRANTY; without even the implied warranty of
 * MERCHANTABILITY or FITNESS FOR A PARTICULAR PURPOSE.  See the
 * GNU General Public License for more details.
 */

&mdss_mdp {
	dsi_pd1957_ft8006p_tianma_hdplus_video: qcom,mdss_dsi_pd1957_ft8006p_tianma_hdplus_video {
		qcom,mdss-dsi-panel-name = "dsi_pd1957_ft8006p_tianma_hdplus_video panel";
		qcom,mdss-dsi-project-name = "pd1957";
		qcom,mdss-dsi-panel-type = "dsi_video_mode";
		qcom,mdss-dsi-virtual-channel-id = <0>;
		qcom,mdss-dsi-stream = <0>;
		qcom,mdss-dsi-bpp = <24>;
		qcom,mdss-dsi-underflow-color = <0xff>;
		qcom,mdss-dsi-border-color = <0>;
		qcom,mdss-dsi-reset-sequence = <1 22>; /* ft8006p only request rising edge */
		qcom,mdss-pan-physical-width-dimension = <69>;
		qcom,mdss-pan-physical-height-dimension = <146>;
		qcom,mdss-dsi-traffic-mode = "non_burst_sync_event";
		qcom,mdss-dsi-bllp-eof-power-mode;
		qcom,mdss-dsi-bllp-power-mode;
		qcom,mdss-dsi-lane-0-state;
		qcom,mdss-dsi-lane-1-state;
		qcom,mdss-dsi-lane-2-state;
		qcom,mdss-dsi-bl-min-level = <1>;
		qcom,mdss-dsi-bl-max-level = <2047>;
		qcom,mdss-brightness-max-level = <4095>;
		qcom,mdss-dsi-bl-pmic-control-type = "bl_ctrl_dcs";
		qcom,mdss-dsi-dma-trigger = "trigger_sw";
		qcom,mdss-dsi-mdp-trigger = "none";
		qcom,mdss-dsi-panel-id = <0x15>;
		qcom,mdss-dsi-lp11-init;
		qcom,vivo-dsi-panel-type = "tft";
		qcom,mdss-panel-sre;
		qcom,mdss-dsi-lcm-sre-max-level = <0x40>;

		qcom,mdss-dsi-display-timings {
			timing@0{
				qcom,mdss-dsi-panel-width = <720>;
				qcom,mdss-dsi-panel-height = <1544>;
				qcom,mdss-dsi-h-front-porch = <90>;
				qcom,mdss-dsi-h-back-porch = <74>;
				qcom,mdss-dsi-h-pulse-width = <14>;
				qcom,mdss-dsi-h-sync-skew = <0>;
				qcom,mdss-dsi-h-sync-pulse = <0>;
				qcom,mdss-dsi-v-back-porch = <106>;
				qcom,mdss-dsi-v-front-porch = <130>;
				qcom,mdss-dsi-v-pulse-width = <8>;
				qcom,mdss-dsi-panel-framerate = <60>;
				qcom,mdss-dsi-h-left-border = <0>;
				qcom,mdss-dsi-h-right-border = <0>;
				qcom,mdss-dsi-v-top-border = <0>;
				qcom,mdss-dsi-v-bottom-border = <0>;
				qcom,mdss-dsi-on-command =
				[
					29 01 00 00 00 00 02 41 5A
					29 01 00 00 00 00 03 41 5A 09
					29 01 00 00 00 00 06 80 64 00 64 00 00
					29 01 00 00 00 00 03 41 5A 0A
					29 01 00 00 00 00 11 80 A5 3E A5 AA A5 88 42 6B A6 03 07 01 64 3F 50 32
					29 01 00 00 00 00 11 90 0C 0F 44 00 2A 18 64 00 88 03 00 FF FF 00 3F 2A
					29 01 00 00 00 00 11 A0 00 30 02 32 11 0D 60 01 FF FF 03 40 42 0F 94 11
					29 01 00 00 00 00 11 B0 E8 03 00 00 11 0D 60 00 FF FF 03 FF 34 0C 0F 0E
					29 01 00 00 00 00 0B C0 1F 03 00 08 20 34 00 00 00 00
					29 01 00 00 00 00 03 41 5A 0B
					29 01 00 00 00 00 11 80 FF AA D2 00 00 0B 21 34 3F 4B 5C 6A 6B 77 77 8A
					29 01 00 00 00 00 11 90 7B 6A 6C 62 5A 4E 3F 35 2C 1B 06 01 00 0B 21 34
					29 01 00 00 00 00 11 A0 3F 4B 5C 6A 6B 77 77 8A 7B 6A 6C 62 5A 4E 3F 35
					29 01 00 00 00 00 06 B0 2C 1B 06 01 00
					29 01 00 00 00 00 03 41 5A 0C
					29 01 00 00 00 00 11 80 00 00 20 42 00 00 80 05 54 00 00 00 20 42 00 00
					29 01 00 00 00 00 03 90 80 05
					29 01 00 00 00 00 03 41 5A 0D
					29 01 00 00 00 00 11 80 7A D0 02 08 06 FA 00 FA 00 0A 0A 0A 0A 00 01 03
					29 01 00 00 00 00 11 90 00 00 00 00 AC A2 2A 00 00 00 AC A2 2A 57 31 00
					29 01 00 00 00 00 11 A0 00 00 00 00 00 AC A2 2A AA C2 2A AC A2 2A AA C2
					29 01 00 00 00 00 07 B0 2A 00 00 00 AA 52
					29 01 00 00 00 00 03 41 5A 0E
					29 01 00 00 00 00 0D 80 F1 B1 71 EF 4B 20 37 0F AA AA 00 00
					29 01 00 00 00 00 03 41 5A 0F
					29 01 00 00 00 00 0C 80 FF 00 55 55 23 88 88 1C 00 5A 5A
					29 01 00 00 00 00 03 41 5A 10
					29 01 00 00 00 00 11 80 B5 45 09 18 01 3C 94 32 10 C4 C4 04 00 60 C0 00
					29 01 00 00 00 00 11 90 04 00 00 86 10 31 98 34 34 34 26 26 3E 1A 62 20
					29 01 00 00 00 00 05 A0 0C 40 00 8A
					29 01 00 00 00 00 03 41 5A 11
					29 01 00 00 00 00 11 80 00 00 03 E7 1F 17 28 48 68 12 90 1A 30 88 41 8A
					29 01 00 00 00 00 10 90 39 28 A9 C5 9A 7B F0 07 7E E0 07 7E 20 10 00
					29 01 00 00 00 00 03 41 5A 12
					29 01 00 00 00 00 11 80 00 00 00 00 00 01 00 00 00 00 00 01 00 03 41 37
					29 01 00 00 00 00 11 90 2D 23 19 0F 05 FB 05 FB 00 00 00 00 00 00 00 00
					29 01 00 00 00 00 11 A0 00 00 00 00 00 00 00 00 00 00 00 00 14 00 00 02
					29 01 00 00 00 00 11 B0 00 00 00 00 00 00 00 00 00 2D 23 0C 07 25 2D 23
					29 01 00 00 00 00 05 C0 05 FB 00 01
					29 01 00 00 00 00 03 41 5A 13
					29 01 00 00 00 00 11 80 FD 0F 00 0C 00 80 80 82 00 07 22 06 E7 B9 86 1A
					29 01 00 00 00 00 11 90 32 00 A2 2D 65 00 00 00 00 D0 C9 B7 FE 26 6F 32
					29 01 00 00 00 00 04 A0 22 90 04
					29 01 00 00 00 00 03 41 5A 14
					29 01 00 00 00 00 11 80 01 02 40 5E D1 DF EF F7 FB FD 02 00 00 04 8B 8B
					29 01 00 00 00 00 11 90 11 7C 40 3C 8C E0 03 62 65 04 1F 10 2B 23 F8 00
					29 01 00 00 00 00 11 A0 00 F8 FD 00 00 C0 EF 07 00 2F 16 6B C5 EF 8F 40
					29 01 00 00 00 00 11 B0 B0 13 BF 3F 02 00 00 00 00 B8 60 0B 56 00 80 42
					29 01 00 00 00 00 11 C0 A1 F0 16 EE 6E 02 00 00 DE C1 DD 4D 00 00 C0 1B
					29 01 00 00 00 00 11 D0 B8 BB 09 00 00 78 01 77 37 01 00 00 AF E0 EE 26
					29 01 00 00 00 00 11 E0 00 00 E0 25 DC DD 04 00 00 BC 86 BB 9B 00 00 80
					29 01 00 00 00 00 11 F0 17 71 77 13 00 00 30 06 7E 3F 14 00 00 00 00 00
					29 01 00 00 00 00 03 41 5A 15
					29 01 00 00 00 00 11 80 00 00 00 00 00 00 00 00 00 00 00 00 0C 80 FF EF
					29 01 00 00 00 00 11 90 27 03 0B D6 88 51 AB 0D A1 D5 3E 62 D4 6A 43 68
					29 01 00 00 00 00 11 A0 B5 00 00 00 00 00 00 00 00 00 00 00 00 00 00 00
					29 01 00 00 00 00 11 B0 00 00 00 00 00 00 00 00 26 00 E0 01 28 6D 1A 56
					29 01 00 00 00 00 11 C0 97 69 46 93 A3 18 42 DB B6 6D DB B6 6D DB B6 6D
					29 01 00 00 00 00 11 D0 DB B6 6D DB B6 6D DB B6 6D DB B6 6D DB B6 6B 1A
					29 01 00 00 00 00 11 E0 52 96 69 42 12 83 10 40 DB B6 6D DB B6 6D DB B6
					29 01 00 00 00 00 11 F0 6D DB B6 6D DB B6 6D DB B6 6D DB B6 6D DB B6 A4
					29 01 00 00 00 00 03 41 5A 16
					29 01 00 00 00 00 11 80 82 82 82 02 00 00 00 00 00 00 00 00 00 00 00 00
					29 01 00 00 00 00 0B 90 00 00 00 00 80 42 2A 01 00 00
					29 01 00 00 00 00 03 41 5A 18
					29 01 00 00 00 00 11 80 EF BD F7 DE 7B EF BD 07 08 08 0A 0C 0C 0C 0C 0C
					29 01 00 00 00 00 11 90 0C 0C 0C 5C 09 A8 AA AA AA AA AA AA AA AA AA 5A
					29 01 00 00 00 00 11 A0 59 59 59 59 59 59 59 59 59 59 59 09 04 FF 00 80
					29 01 00 00 00 00 10 B0 80 00 04 20 00 01 08 40 00 02 10 80 00 04 00
					29 01 00 00 00 00 03 41 5A 19
					29 01 00 00 00 00 11 80 C8 B8 A9 9E 95 8D 87 82 80 80 80 80 77 F7 FF FF
					29 01 00 00 00 00 11 90 FF 0F F0 BF 7F 4F 0F FF 6F 52 8D 4A E8 E7 07 08
					29 01 00 00 00 00 05 A0 00 00 46 00
					29 01 00 00 00 00 03 41 5A 1A
					29 01 00 00 00 00 11 80 FF 00 04 08 0C 50 10 14 18 1C A5 20 28 30 39 3E
					29 01 00 00 00 00 11 90 41 49 51 59 94 61 69 71 79 FA 81 8A 92 9A 03 A2
					29 01 00 00 00 00 11 A0 AA B2 BA 00 C2 CA D1 D9 F0 E1 E9 F0 F8 06 FC FE
					29 01 00 00 00 00 11 B0 FF 00 00 04 08 0C 00 10 14 18 1C 00 20 28 30 37
					29 01 00 00 00 00 11 C0 C0 3F 47 4F 57 FF 5F 67 6F 77 FF 7F 87 8F 97 FF
					29 01 00 00 00 00 11 D0 9F A7 AF B7 FF BF C7 CF D7 FF E0 E8 F0 F8 00 FC
					29 01 00 00 00 00 11 E0 FE FF 00 00 03 07 0B 6C 0F 12 16 1A 6C 1E 26 2E
					29 01 00 00 00 00 11 F0 35 C0 3D 45 4D 55 1A 5C 64 6C 73 C7 7B 83 8B 92
					29 01 00 00 00 00 03 41 5A 1B
					29 01 00 00 00 00 11 80 86 9A A2 A9 B1 B1 B9 C1 C8 D0 F1 D8 E0 E9 F1 AF
					29 01 00 00 00 00 06 90 F5 F7 F8 15 00
					29 01 00 00 00 00 03 41 5A 1C
					29 01 00 00 00 00 11 80 33 22 00 03 5A 02 5A 54 E5 FF C7 00 18 20 18 08
					29 01 00 00 00 00 11 90 10 0C 07 09 06 06 0A 10 0C 09 0B 06 26 F2 78 40
					29 01 00 00 00 00 11 A0 20 08 08 06 13 80 34 1E 0A 08 66 D1 A0 1C 40 20
					29 01 00 00 00 00 11 B0 12 0C 20 00 80 04 18 01 48 00 22 18 10 0A 06 C9
					29 01 00 00 00 00 11 C0 04 70 81 58 54 B5 4A 55 15 00 78 F8 99 99 99 99
					29 01 00 00 00 00 11 D0 99 19 11 11 11 11 11 11 10 C0 E3 81 00 20 80 27
					29 01 00 00 00 00 11 E0 E2 89 00 00 00 00 40 00 00 31 04 41 B6 6D DB B6
					29 01 00 00 00 00 11 F0 6D DB B6 6D DB B6 6D DB B6 6D DB B6 6D C0 03 40
					29 01 00 00 00 00 03 41 5A 1D
					29 01 00 00 00 00 11 80 00 01 54 0B 23 18 00 00 80 00 00 00 00 00 00 00
					29 01 00 00 00 00 03 41 5A 22
					29 01 00 00 00 00 10 80 00 5E 00 00 00 00 00 00 5E 00 00 00 00 00 00
					29 01 00 00 00 00 03 41 5A 24
					29 01 00 00 00 00 11 80 2D D3 00 55 55 55 55 55 55 55 55 1F 00 AA 3E 00
					29 01 00 00 00 00 05 90 00 00 00 00
					29 01 00 00 00 00 03 41 5A 25
					29 01 00 00 00 00 11 80 01 05 00 05 00 00 00 15 01 00 00 00 00 00 01 00
					29 01 00 00 00 00 0C 90 00 00 00 24 00 00 00 00 DD 07 35
					29 01 00 00 00 00 03 41 5A 26
					29 01 00 00 00 00 11 80 00 83 00 FF FF 60 00 01 00 00 00 00 00 00 13 B5
					29 01 00 00 00 00 04 90 5A A5 5A
					29 01 00 00 00 00 02 90 A5
					29 01 00 00 00 00 03 41 00 2F
					29 01 00 00 00 00 02 4C 03
					05 01 00 00 5A 00 01 11
					29 01 00 00 00 00 03 51 00 00
					29 01 00 00 00 00 02 53 24
					29 01 00 00 00 00 02 55 00
					05 01 00 00 0A 00 01 29
				];

				qcom,mdss-oled-acl-on-command-level1 = [
					29 01 00 00 00 00 02 53 2C
					29 01 00 00 00 00 02 55 01
				];

				qcom,mdss-oled-acl-on-command-level2 = [
					29 01 00 00 00 00 02 53 2C
					29 01 00 00 00 00 02 55 02
				];

				qcom,mdss-oled-acl-on-command-level3 = [
					29 01 00 00 00 00 02 53 2C
					29 01 00 00 00 00 02 55 03
				];

				qcom,mdss-oled-acl-off-command = [
					29 01 00 00 00 00 02 53 2C
					29 01 00 00 00 00 02 55 00
				];

				qcom,mdss-dsi-off-command = [
					05 01 00 00 00 00 01 28
					05 01 00 00 00 00 01 10
					29 01 00 00 00 00 03 41 5A 0E
					29 01 00 00 00 00 02 80 71
					29 01 00 00 96 00 03 41 00 2F
				];

				qcom,mdss-dsi-on-command-state = "dsi_lp_mode";
				qcom,mdss-dsi-off-command-state = "dsi_lp_mode";
				qcom,mdss-alpm-command-state = "dsi_hs_mode";
			};
		};
	};
};
