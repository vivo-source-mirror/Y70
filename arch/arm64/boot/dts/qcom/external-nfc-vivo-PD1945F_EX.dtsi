
&qupv3_se1_i2c {
	status = "ok";
	nq@28 {
		compatible = "qcom,nq-nci";
		reg = <0x28>;
		vivo,nfc_support = <1>;
		vivo,boardversion_shift = <3>;
		vivo,boardversion_mask = <4>;
		vivo,boardversion_num = <4>;
		vivo,boardversions = "0001","0011","0101","0111";

		qcom,nq-irq = <&tlmm 85 0x00>;
		qcom,nq-ven = <&tlmm 83 0x00>;
		qcom,nq-firm = <&tlmm 84 0x00>;
		//qcom,nq-clkreq = <&tlmm 95 0x00>; //use XTAL
		//qcom,nq-esepwr = <&tlmm 82 0x00>;
		interrupt-parent = <&tlmm>;
		interrupts = <85 0>;
		interrupt-names = "nfc_irq";
		pinctrl-names = "nfc_active", "nfc_suspend";
		pinctrl-0 = <&nfc_int_active &nfc_enable_active
				&nfc_clk_req_active>;
		pinctrl-1 = <&nfc_int_suspend &nfc_enable_suspend
				&nfc_clk_req_suspend>;
		status = "ok";
	};
};
