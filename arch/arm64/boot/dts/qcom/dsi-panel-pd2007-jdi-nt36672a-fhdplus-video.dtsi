/* Copyright (c) 2019, The Linux Foundation. All rights reserved.
 *
 * This program is free software; you can redistribute it and/or modify
 * it under the terms of the GNU General Public License version 2 and
 * only version 2 as published by the Free Software Foundation.
 *
 * This program is distributed in the hope that it will be useful,
 * but WITHOUT ANY WARRANTY; without even the implied warranty of
 * MERCHANTABILITY or FITNESS FOR A PARTICULAR PURPOSE.  See the
 * GNU General Public License for more details.
 */

&mdss_mdp {
	dsi_pd2007_jdi_nt36672a_fhdplus_video: qcom,mdss_dsi_pd2007_jdi_nt36672a_fhdplus_video {
		qcom,mdss-dsi-panel-name = "dsi_pd2007_jdi_nt36672a_fhdplus_video panel";
		qcom,mdss-dsi-project-name = "pd2007";
		qcom,mdss-dsi-panel-type = "dsi_video_mode";
		qcom,mdss-dsi-virtual-channel-id = <0>;
		qcom,mdss-dsi-stream = <0>;
		qcom,mdss-dsi-bpp = <24>;
		qcom,mdss-dsi-underflow-color = <0xff>;
		qcom,mdss-dsi-border-color = <0>;
		qcom,mdss-dsi-reset-sequence = <0 10>, <1 10>;
		qcom,mdss-pan-physical-width-dimension = <67>;
		qcom,mdss-pan-physical-height-dimension = <149>;
		qcom,mdss-dsi-traffic-mode = "burst_mode";
		qcom,mdss-dsi-bllp-eof-power-mode;
		qcom,mdss-dsi-bllp-power-mode;
		qcom,mdss-dsi-lane-0-state;
		qcom,mdss-dsi-lane-1-state;
		qcom,mdss-dsi-lane-2-state;
		qcom,mdss-dsi-lane-3-state;
		qcom,mdss-dsi-dma-trigger = "trigger_sw";
		qcom,mdss-dsi-mdp-trigger = "none";
		qcom,mdss-dsi-panel-id = <0x41>;
		qcom,mdss-dsi-lp11-init;
		qcom,vivo-dsi-panel-type = "tft";
		qcom,mdss-panel-sre;
		qcom,mdss-dsi-lcm-sre-max-level = <0xF0>;

		qcom,mdss-dsi-display-timings {
			timing@0{
				qcom,mdss-dsi-panel-width = <1080>;
				qcom,mdss-dsi-panel-height = <2400>;
				qcom,mdss-dsi-h-front-porch = <80>;
				qcom,mdss-dsi-h-back-porch = <80>;
				qcom,mdss-dsi-h-pulse-width = <59>;
				qcom,mdss-dsi-h-sync-skew = <0>;
				qcom,mdss-dsi-h-sync-pulse = <0>;
				qcom,mdss-dsi-v-back-porch = <15>;
				qcom,mdss-dsi-v-front-porch = <18>;
				qcom,mdss-dsi-v-pulse-width = <2>;
				qcom,mdss-dsi-panel-framerate = <60>;
				qcom,mdss-dsi-h-left-border = <0>;
				qcom,mdss-dsi-h-right-border = <0>;
				qcom,mdss-dsi-v-top-border = <0>;
				qcom,mdss-dsi-v-bottom-border = <0>;
				qcom,mdss-dsi-on-command =
				[
					39 01 00 00 00 00 02 FF 10
					39 01 00 00 00 00 02 FB 01
					39 01 00 00 00 00 02 FF 20
					39 01 00 00 00 00 02 FB 01
					39 01 00 00 00 00 02 06 99
					39 01 00 00 00 00 02 07 A3
					39 01 00 00 00 00 02 0E AB
					39 01 00 00 00 00 02 0F AE
					39 01 00 00 00 00 02 62 A4
					39 01 00 00 00 00 02 6D 44
					39 01 00 00 00 00 02 78 01
					39 01 00 00 00 00 02 95 E1
					39 01 00 00 00 00 02 96 E1
					//gamma
					39 01 00 00 00 00 02 FF 20
					39 01 00 00 00 00 02 FB 01
					//R(+ 
					39 01 00 00 00 00 11 B0 00 00 00 20 00 5A 00 88 00 AB 00 C7 00 DE 00 F1
					39 01 00 00 00 00 11 B1 01 03 01 3B 01 63 01 A2 01 CD 02 12 02 47 02 49
					39 01 00 00 00 00 11 B2 02 7C 02 B7 02 DD 03 0D 03 2E 03 53 03 63 03 71
					39 01 00 00 00 00 0F B3 03 84 03 9C 03 B7 03 CD 03 D6 03 D8 00 00
					//G(+ 
					39 01 00 00 00 00 11 B4 00 00 00 20 00 5A 00 88 00 AB 00 C7 00 DE 00 F1
					39 01 00 00 00 00 11 B5 01 03 01 3B 01 63 01 A2 01 CD 02 12 02 47 02 49
					39 01 00 00 00 00 11 B6 02 7C 02 B7 02 DD 03 0D 03 2E 03 53 03 63 03 71
					39 01 00 00 00 00 0F B7 03 84 03 9C 03 B7 03 CD 03 D6 03 D8 00 00
					//B(+ 
					39 01 00 00 00 00 11 B8 00 00 00 20 00 5A 00 88 00 AB 00 C7 00 DE 00 F1
					39 01 00 00 00 00 11 B9 01 03 01 3B 01 63 01 A2 01 CD 02 12 02 47 02 49
					39 01 00 00 00 00 11 BA 02 7C 02 B7 02 DD 03 0D 03 2E 03 53 03 63 03 71
					39 01 00 00 00 00 0F BB 03 84 03 9C 03 B7 03 CD 03 D6 03 D8 00 00
					39 01 00 00 00 00 02 FF 21
					39 01 00 00 00 00 02 FB 01
					//R(- 
					39 01 00 00 00 00 11 B0 00 00 00 18 00 52 00 80 00 A3 00 BF 00 D6 00 E9
					39 01 00 00 00 00 11 B1 00 FB 01 33 01 5B 01 9A 01 C5 02 0A 02 3F 02 41
					39 01 00 00 00 00 11 B2 02 74 02 AF 02 D5 03 05 03 26 03 4B 03 5B 03 69
					39 01 00 00 00 00 0F B3 03 7C 03 94 03 AF 03 C5 03 D6 03 D8 00 00
					//G(- 
					39 01 00 00 00 00 11 B4 00 00 00 18 00 52 00 80 00 A3 00 BF 00 D6 00 E9
					39 01 00 00 00 00 11 B5 00 FB 01 33 01 5B 01 9A 01 C5 02 0A 02 3F 02 41
					39 01 00 00 00 00 11 B6 02 74 02 AF 02 D5 03 05 03 26 03 4B 03 5B 03 69
					39 01 00 00 00 00 0F B7 03 7C 03 94 03 AF 03 C5 03 D6 03 D8 00 00
					//B(- 
					39 01 00 00 00 00 11 B8 00 00 00 18 00 52 00 80 00 A3 00 BF 00 D6 00 E9
					39 01 00 00 00 00 11 B9 00 FB 01 33 01 5B 01 9A 01 C5 02 0A 02 3F 02 41
					39 01 00 00 00 00 11 BA 02 74 02 AF 02 D5 03 05 03 26 03 4B 03 5B 03 69
					39 01 00 00 00 00 0F BB 03 7C 03 94 03 AF 03 C5 03 D6 03 D8 00 00
					//cabc
					39 01 00 00 00 00 02 FF 23
					39 01 00 00 00 00 02 FB 01
					39 01 00 00 00 00 02 00 80
					39 01 00 00 00 00 02 04 05
					39 01 00 00 00 00 02 05 2d
					39 01 00 00 00 00 02 06 01
					39 01 00 00 00 00 02 07 00
					39 01 00 00 00 00 02 08 01
					39 01 00 00 00 00 02 09 00

					39 01 00 00 00 00 02 11 01
					39 01 00 00 00 00 02 12 95
					39 01 00 00 00 00 02 15 68
					39 01 00 00 00 00 02 16 0B

					39 01 00 00 00 00 02 30 FF
					39 01 00 00 00 00 02 31 F0
					39 01 00 00 00 00 02 32 EB
					39 01 00 00 00 00 02 33 E5
					39 01 00 00 00 00 02 34 DD
					39 01 00 00 00 00 02 35 DA
					39 01 00 00 00 00 02 36 D5
					39 01 00 00 00 00 02 37 D0
					39 01 00 00 00 00 02 38 CE
					39 01 00 00 00 00 02 39 CD
					39 01 00 00 00 00 02 3A CD
					39 01 00 00 00 00 02 3B CD
					39 01 00 00 00 00 02 3D CB
					39 01 00 00 00 00 02 3F CB
					39 01 00 00 00 00 02 40 C6
					39 01 00 00 00 00 02 41 BF

					39 01 00 00 00 00 02 45 FF
					39 01 00 00 00 00 02 46 F0
					39 01 00 00 00 00 02 47 E8
					39 01 00 00 00 00 02 48 CE
					39 01 00 00 00 00 02 49 BC
					39 01 00 00 00 00 02 4A B8
					39 01 00 00 00 00 02 4B B5
					39 01 00 00 00 00 02 4C B0
					39 01 00 00 00 00 02 4D A8
					39 01 00 00 00 00 02 4E A0
					39 01 00 00 00 00 02 4F 9B
					39 01 00 00 00 00 02 50 98
					39 01 00 00 00 00 02 51 98
					39 01 00 00 00 00 02 52 88
					39 01 00 00 00 00 02 53 80
					39 01 00 00 00 00 02 54 7F

					39 01 00 00 00 00 02 58 FF
					39 01 00 00 00 00 02 59 F6
					39 01 00 00 00 00 02 5A ED
					39 01 00 00 00 00 02 5B E6
					39 01 00 00 00 00 02 5C DF
					39 01 00 00 00 00 02 5D D8
					39 01 00 00 00 00 02 5E D3
					39 01 00 00 00 00 02 5F CE
					39 01 00 00 00 00 02 60 C9
					39 01 00 00 00 00 02 61 C4
					39 01 00 00 00 00 02 62 C1
					39 01 00 00 00 00 02 63 BE
					39 01 00 00 00 00 02 64 BB
					39 01 00 00 00 00 02 65 B8
					39 01 00 00 00 00 02 66 B6
					39 01 00 00 00 00 02 67 B5 

					39 01 00 00 00 00 02 FF 10
					39 01 00 00 00 00 02 FB 01
					39 01 00 00 00 00 03 68 03 01
					39 01 00 00 00 00 02 53 24
					39 01 00 00 00 00 02 51 FF

					39 01 00 00 00 00 02 FF 24
					39 01 00 00 00 00 02 FB 01
					39 01 00 00 00 00 02 00 1C
					39 01 00 00 00 00 02 01 1C
					39 01 00 00 00 00 02 02 1C
					39 01 00 00 00 00 02 03 1C
					39 01 00 00 00 00 02 04 1C
					39 01 00 00 00 00 02 05 1C
					39 01 00 00 00 00 02 06 1C
					39 01 00 00 00 00 02 07 9F
					39 01 00 00 00 00 02 08 9F
					39 01 00 00 00 00 02 09 00
					39 01 00 00 00 00 02 0A 1E
					39 01 00 00 00 00 02 0B 0D
					39 01 00 00 00 00 02 0C 0D
					39 01 00 00 00 00 02 0D 14
					39 01 00 00 00 00 02 0E 12
					39 01 00 00 00 00 02 0F 10
					39 01 00 00 00 00 02 10 03
					39 01 00 00 00 00 02 11 04
					39 01 00 00 00 00 02 12 24
					39 01 00 00 00 00 02 13 20
					39 01 00 00 00 00 02 14 20
					39 01 00 00 00 00 02 15 09
					39 01 00 00 00 00 02 16 0A
					39 01 00 00 00 00 02 17 1C
					39 01 00 00 00 00 02 18 1C
					39 01 00 00 00 00 02 19 1C
					39 01 00 00 00 00 02 1A 1C
					39 01 00 00 00 00 02 1B 1C
					39 01 00 00 00 00 02 1C 1C
					39 01 00 00 00 00 02 1D 1C
					39 01 00 00 00 00 02 1E 9F
					39 01 00 00 00 00 02 1F 9F
					39 01 00 00 00 00 02 20 00
					39 01 00 00 00 00 02 21 1E
					39 01 00 00 00 00 02 22 0D
					39 01 00 00 00 00 02 23 0D
					39 01 00 00 00 00 02 24 14
					39 01 00 00 00 00 02 25 12
					39 01 00 00 00 00 02 26 10
					39 01 00 00 00 00 02 27 03
					39 01 00 00 00 00 02 28 04
					39 01 00 00 00 00 02 29 24
					39 01 00 00 00 00 02 2A 20
					39 01 00 00 00 00 02 2B 20
					39 01 00 00 00 00 02 2D 09
					39 01 00 00 00 00 02 2F 0A
					39 01 00 00 00 00 02 31 02
					39 01 00 00 00 00 02 32 03
					39 01 00 00 00 00 02 33 0A
					39 01 00 00 00 00 02 34 05
					39 01 00 00 00 00 02 35 49
					39 01 00 00 00 00 02 37 00
					39 01 00 00 00 00 02 38 66
					39 01 00 00 00 00 02 39 66
					39 01 00 00 00 00 02 3F 66
					39 01 00 00 00 00 02 41 02
					39 01 00 00 00 00 02 42 03
					39 01 00 00 00 00 02 4C 01
					39 01 00 00 00 00 02 4D 01
					39 01 00 00 00 00 02 60 90
					39 01 00 00 00 00 02 61 60
					39 01 00 00 00 00 02 72 00
					39 01 00 00 00 00 02 73 00
					39 01 00 00 00 00 02 74 00
					39 01 00 00 00 00 02 75 00
					39 01 00 00 00 00 02 79 00
					39 01 00 00 00 00 02 7A 05
					39 01 00 00 00 00 02 7B 1B
					39 01 00 00 00 00 02 7D 05
					39 01 00 00 00 00 02 80 42
					39 01 00 00 00 00 02 82 13
					39 01 00 00 00 00 02 83 22
					39 01 00 00 00 00 02 84 31
					39 01 00 00 00 00 02 85 00
					39 01 00 00 00 00 02 86 00
					39 01 00 00 00 00 02 87 00
					39 01 00 00 00 00 02 88 13
					39 01 00 00 00 00 02 89 22
					39 01 00 00 00 00 02 8A 31
					39 01 00 00 00 00 02 8B 00
					39 01 00 00 00 00 02 8C 00
					39 01 00 00 00 00 02 8D 00
					39 01 00 00 00 00 02 8E F4
					39 01 00 00 00 00 02 8F 01
					39 01 00 00 00 00 02 90 80
					39 01 00 00 00 00 02 92 6E
					39 01 00 00 00 00 02 93 12
					39 01 00 00 00 00 02 94 11
					39 01 00 00 00 00 02 B3 02
					39 01 00 00 00 00 02 B4 00
					39 01 00 00 00 00 02 DC 29
					39 01 00 00 00 00 02 DD 02
					39 01 00 00 00 00 02 DE 00
					39 01 00 00 00 00 02 DF 01
					39 01 00 00 00 00 02 E0 01
					39 01 00 00 00 00 02 E1 0C
					39 01 00 00 00 00 02 E2 0A
					39 01 00 00 00 00 02 EB 05

					39 01 00 00 00 00 02 FF 25
					39 01 00 00 00 00 02 FB 01
					39 01 00 00 00 00 02 21 1B
					39 01 00 00 00 00 02 22 1B
					39 01 00 00 00 00 02 24 6E
					39 01 00 00 00 00 02 25 6E
					39 01 00 00 00 00 02 30 2E
					39 01 00 00 00 00 02 31 2E
					39 01 00 00 00 00 02 38 2E
					39 01 00 00 00 00 02 3F 11
					39 01 00 00 00 00 02 40 6F
					39 01 00 00 00 00 02 41 6F
					39 01 00 00 00 00 02 4B 21
					39 01 00 00 00 00 02 4C 6F
					39 01 00 00 00 00 02 66 D8
					39 01 00 00 00 00 02 67 01
					39 01 00 00 00 00 02 68 58
					39 01 00 00 00 00 02 69 10
					39 01 00 00 00 00 02 6B 00
					39 01 00 00 00 00 02 6C 15
					39 01 00 00 00 00 02 71 1D
					39 01 00 00 00 00 02 77 62
					39 01 00 00 00 00 02 7E 15
					39 01 00 00 00 00 02 7F 00
					39 01 00 00 00 00 02 84 6D
					39 01 00 00 00 00 02 8D 00
					39 01 00 00 00 00 02 BF 00
					39 01 00 00 00 00 02 C0 D5
					39 01 00 00 00 00 02 C1 11
					39 01 00 00 00 00 02 C2 51
					39 01 00 00 00 00 02 C3 00
					39 01 00 00 00 00 02 D9 48
					39 01 00 00 00 00 02 DB 22

					39 01 00 00 00 00 02 FF 26
					39 01 00 00 00 00 02 FB 01
					39 01 00 00 00 00 02 06 FF
					39 01 00 00 00 00 02 12 77
					39 01 00 00 00 00 02 1A 7F
					39 01 00 00 00 00 02 1C AF
					39 01 00 00 00 00 02 1D 0B
					39 01 00 00 00 00 02 1E 02
					39 01 00 00 00 00 02 98 F1
					39 01 00 00 00 00 02 A9 11
					39 01 00 00 00 00 02 AA 11
					39 01 00 00 00 00 02 AE 8A

					39 01 00 00 00 00 02 FF 27
					39 01 00 00 00 00 02 FB 01
					39 01 00 00 00 00 02 13 00
					39 01 00 00 00 00 02 1E 14
					39 01 00 00 00 00 02 22 00
					39 01 00 00 00 00 02 B3 01
					39 01 00 00 00 00 02 B5 80

					39 01 00 00 00 00 02 FF 10
					39 01 00 00 64 00 02 11 00
					39 01 00 00 14 00 02 29 00
				];

				qcom,mdss-oled-acl-off-command = [
					39 01 00 00 00 00 02 53 2C
					39 01 00 00 00 00 02 55 00
				];

				qcom,mdss-oled-acl-on-command-level1 = [
					39 01 00 00 00 00 02 53 2C
					39 01 00 00 00 00 02 55 01
				];

				qcom,mdss-oled-acl-on-command-level2 = [
					39 01 00 00 00 00 02 53 2C
					39 01 00 00 00 00 02 55 02
				];

				qcom,mdss-oled-acl-on-command-level3 = [
					39 01 00 00 00 00 02 53 2C
					39 01 00 00 00 00 02 55 02
				];

				qcom,mdss-lcm-sre-off-command = [
					39 01 00 00 00 00 02 55 00
				];

				qcom,mdss-lcm-sre-level1-command = [
					39 01 00 00 00 00 02 55 40
				];

				qcom,mdss-lcm-sre-level2-command = [
					39 01 00 00 00 00 02 55 60
				];

				qcom,mdss-dsi-all-pixels-off-command = [
					/*all pixel off*/
					39 01 00 00 20 00 02 22 00
				];

				qcom,mdss-dsi-all-pixels-on-command = [
					39 01 00 00 20 00 02 13 00
				];

				qcom,mdss-dsi-off-command = [
					39 01 00 00 3C 00 02 28 00
					39 01 00 00 16 00 02 10 00
				];

				qcom,mdss-dsi-on-command-state = "dsi_lp_mode";
				qcom,mdss-dsi-off-command-state = "dsi_hs_mode";
				qcom,mdss-dsi-all-pixels-off-command-state = "dsi_lp_mode";
				qcom,mdss-dsi-all-pixels-on-command-state = "dsi_lp_mode";
				qcom,mdss-alpm-command-state = "dsi_hs_mode";
			};
		};
	};
};
