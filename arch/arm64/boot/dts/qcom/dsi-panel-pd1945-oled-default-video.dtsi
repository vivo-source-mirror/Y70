/* Copyright (c) 2019, The Linux Foundation. All rights reserved.
 *
 * This program is free software; you can redistribute it and/or modify
 * it under the terms of the GNU General Public License version 2 and
 * only version 2 as published by the Free Software Foundation.
 *
 * This program is distributed in the hope that it will be useful,
 * but WITHOUT ANY WARRANTY; without even the implied warranty of
 * MERCHANTABILITY or FITNESS FOR A PARTICULAR PURPOSE.  See the
 * GNU General Public License for more details.
 */

&mdss_mdp {
	dsi_pd1945_oled_default_video: qcom,PD1945_oled_default_1080p_video {
		qcom,mdss-dsi-panel-name = "PD1945 s6e3fc2 1080p cmd mode dsi panel";
		qcom,mdss-dsi-panel-type = "dsi_video_mode";
		qcom,mdss-dsi-virtual-channel-id = <0>;
		qcom,mdss-dsi-stream = <0>;
		qcom,mdss-dsi-bpp = <24>;
		qcom,mdss-dsi-underflow-color = <0xff>;
		qcom,mdss-dsi-border-color = <0>;
		qcom,mdss-dsi-reset-sequence = <1 10>, <0 10>, <1 10>;
		qcom,mdss-pan-physical-width-dimension = <68>;
		qcom,mdss-pan-physical-height-dimension = <147>;
		qcom,mdss-dsi-traffic-mode = "burst_mode";//"non_burst_sync_event";
		qcom,mdss-dsi-bllp-eof-power-mode;
		qcom,mdss-dsi-bllp-power-mode;
		qcom,mdss-dsi-lane-0-state;
		qcom,mdss-dsi-lane-1-state;
		qcom,mdss-dsi-lane-2-state;
		qcom,mdss-dsi-lane-3-state;
		qcom,mdss-dsi-dma-trigger = "trigger_sw";
		qcom,mdss-dsi-mdp-trigger = "none";
		qcom,adjust-timer-wakeup-ms = <1>;
		qcom,mdss-dsi-te-pin-select = <1>;
		qcom,mdss-dsi-wr-mem-start = <0x2c>;
		qcom,mdss-dsi-wr-mem-continue = <0x3c>;
		qcom,mdss-dsi-te-dcs-command = <1>;
		qcom,mdss-dsi-te-check-enable;
		qcom,mdss-dsi-te-using-te-pin;
		qcom,mdss-tear-check-sync-cfg-height = <5000>;
		qcom,mdss-dsi-panel-id = <0x21>;
		qcom,mdss-dsi-project-name = "pd1945";
		qcom,mdss-panel-sre;
		qcom,mdss-dsi-panel-hdr-enabled;
		qcom,mdss-dsi-panel-hdr-color-primaries = <14500 15500 32000 17000 15500 30000 8000 3000>;
		qcom,mdss-dsi-panel-peak-brightness = <4200000>;
		qcom,mdss-dsi-panel-blackness-level = <3230>;
		qcom,vivo-dsi-panel-type = "oled";
		qcom,ud-fingerprint-support;
		/*qcom,dsi-dyn-clk-enable;
		qcom,dsi-dyn-clk-list = <1140046080 1131996423>;*/

		
		/*qcom,esd-check-enabled;*/
		qcom,mdss-dsi-panel-status-check-mode = "reg_read";
		qcom,mdss-dsi-panel-status-command = [06 01 00 01 00 00 01 0a];
		qcom,mdss-dsi-panel-status-command-state = "dsi_lp_mode";
		qcom,mdss-dsi-panel-status-value = <0x9F>;
		qcom,mdss-dsi-panel-on-check-value = <0x9F>;
		qcom,mdss-dsi-panel-status-read-length = <1>;
		qcom,mdss-dsi-t-clk-post = <0x0F>;
		qcom,mdss-dsi-t-clk-pre = <0x3A>;
		qcom,mdss-dsi-t-clk-post-internal = <0x0F>;
		qcom,mdss-dsi-t-clk-pre-internal = <0x3A>;
		qcom,panel-supply-entries = <&dsi_panel_pwr_supply_no_labibb>;
		qcom,mdss-dsi-bl-pmic-control-type = "bl_ctrl_dcs";
		qcom,mdss-dsi-bl-min-level = <1>;
		qcom,mdss-dsi-bl-max-level = <1023>;
		qcom,mdss-brightness-max-level = <1023>;
		qcom,platform-en-gpio = <&tlmm 129 0>;
		/*qcom,platform-te-gpio = <&tlmm 89 0>;*/
		qcom,platform-reset-gpio = <&tlmm 90 0>;
		

		qcom,mdss-dsi-display-timings {
			timing@0{
				qcom,mdss-dsi-panel-clockrate = <1140046080>;
				qcom,mdss-dsi-panel-width = <1080>;
				qcom,mdss-dsi-panel-height = <2340>;
				qcom,mdss-dsi-h-front-porch = <64>;
				qcom,mdss-dsi-h-back-porch = <96>;
				qcom,mdss-dsi-h-pulse-width = <16>;
				qcom,mdss-dsi-h-front-porch-internal = <64>;
				qcom,mdss-dsi-h-back-porch-internal = <96>;
				qcom,mdss-dsi-h-pulse-width-internal = <16>;
				qcom,mdss-dsi-h-sync-skew = <0>;
				qcom,mdss-dsi-v-back-porch = <76>;
				qcom,mdss-dsi-v-front-porch = <60>;
				qcom,mdss-dsi-v-pulse-width = <4>;
				qcom,mdss-dsi-h-left-border = <0>;
				qcom,mdss-dsi-h-right-border = <0>;
				qcom,mdss-dsi-v-top-border = <0>;
				qcom,mdss-dsi-v-bottom-border = <0>;
				qcom,mdss-dsi-panel-framerate = <61>;
				qcom,mdss-dsi-panel-jitter = <0x4 0x1>;

				qcom,mdss-dsi-panel-phy-timings = 
				[27 21 0A 0B 07 03 04 a0
				 27 21 0A 0B 07 03 04 a0
				 27 21 0A 0B 07 03 04 a0
				 27 21 0A 0B 07 03 04 a0
				 27 22 0A 0B 07 03 04 a0]; /* clk lane */
				qcom,mdss-dsi-panel-phy-timings-internal = [
				27 21 0A 0B 07 03 04 a0
				 27 21 0A 0B 07 03 04 a0
				 27 21 0A 0B 07 03 04 a0
				 27 21 0A 0B 07 03 04 a0
				 27 22 0A 0B 07 03 04 a0
				];
				qcom,display-topology = <1 0 1>;
				qcom,default-topology-index = <0>;
				
				qcom,mdss-dsi-on-command = [
					/* Sleep Out */
					39 01 00 00 00 00 03 9F A5 A5
					39 01 00 00 15 00 02 11 00
					39 01 00 00 00 00 03 9F 5A 5A
					/* Common Setting */
					39 01 00 00 00 00 03 F0 5A 5A
					39 01 00 00 00 00 02 B0 07
					39 01 00 00 00 00 02 CD 12
					39 01 00 00 00 00 03 F0 A5 A5
					39 01 00 00 00 00 03 9F A5 A5
					39 01 00 00 00 00 02 35 00
					39 01 00 00 00 00 03 9F 5A 5A
					/*esd sw work around*/
					39 01 00 00 00 00 03 FC 5A 5A
					39 01 00 00 00 00 02 B0 01
					39 01 00 00 00 00 02 E3 88
					39 01 00 00 00 00 02 B0 07
					39 01 00 00 00 00 02 ED 67
					39 01 00 00 00 00 03 FC A5 A5
					/* Brightness Setting */
					39 01 00 00 00 00 03 F0 5A 5A
					39 01 00 00 00 00 02 B0 07
					39 01 00 00 00 00 02 B7 01
					39 01 00 00 00 00 03 F0 A5 A5
					39 01 00 00 65 00 02 53 20
					39 01 00 00 00 00 02 55 00
					/* Display On */
					39 01 00 00 00 00 03 9F A5 A5
					39 01 00 00 00 00 02 29 00
					39 01 00 00 00 00 03 9F 5A 5A
					39 01 00 00 00 00 03 F0 5A 5A
					/* ACL dimming setting */
					39 01 00 00 00 00 02 B0 DE
					39 01 00 00 00 00 02 B9 48
					/* seed setting*/
					39 01 00 00 00 00 02 81 90
					39 01 00 00 00 00 18 B1 00 00 D6 00 00 20 F5 00 00 05 FF 25 FF E4 FF 06 F1 FF F1 00 FF FC FF
					/* up/down area Magenta/Greenish */
					39 01 00 00 00 00 03 B6 00 02
					/* skin color brightness setting*/
					39 01 00 00 00 00 02 B0 1C
					39 01 00 00 00 00 02 B3 00
					39 01 00 00 00 00 02 B0 23
					39 01 00 00 00 00 02 B3 91
					39 01 00 00 00 00 02 B0 21
					39 01 00 00 00 00 02 B3 F8
					39 01 00 00 00 00 02 83 80
					39 01 00 00 00 00 03 B3 00 C0
					39 01 00 00 00 00 03 F0 A5 A5
					39 01 00 00 00 00 03 51 00 00
				];

				/* samsung OLED ORE mode */
				qcom,mdss-oled-seed-ore-on-command =
				[
					39 00 00 00 00 00 03 F0 5A 5A
					39 00 00 00 00 00 03 87 80 00
					39 00 00 00 00 00 02 B0 52
					39 00 00 00 00 00 02 B3 00
					39 01 00 00 00 00 03 F0 A5 A5
				];

				qcom,mdss-oled-seed-ore-off-command =
				[
					39 00 00 00 00 00 03 F0 5A 5A
					39 00 00 00 00 00 02 B0 52
					39 00 00 00 00 00 02 B3 01
					39 01 00 00 00 00 03 F0 A5 A5
				];

				/* samsung OLED CRC mode */
				qcom,mdss-oled-seed-crc-on-command-p3 =
				[
					39 01 00 00 00 00 03 F0 5A 5A
					39 01 00 00 00 00 02 81 90
					39 01 00 00 00 00 18 B1 00 00 D6 00 00 20 F5 00 00 05 FF 25 FF E4 FF 06 F1 FF F1 00 FF FC FF
					39 01 00 00 00 00 03 F0 A5 A5
				];

				/* samsung OLED HBM mode */
				qcom,mdss-oled-seed-crc-on-command-srgb =
				[
					39 01 00 00 00 00 03 F0 5A 5A
					39 01 00 00 00 00 02 81 90
					39 01 00 00 00 00 18 B1 00 00 A8 03 04 44 C8 12 05 09 B3 59 E7 D0 BC 11 BE E5 D8 1A FF F8 E0
					39 01 00 00 00 00 03 F0 A5 A5
				];

				qcom,mdss-oled-seed-crc-off-command =
				[
					39 01 00 00 00 00 03 F0 5A 5A
					39 01 00 00 00 00 02 81 00
					39 01 00 00 00 00 03 B1 00 01
					39 01 00 00 00 00 03 F0 A5 A5
				];

				/*seed crc compenstate default 275~1023*/
				qcom,mdss-oled-seed-crc-compensate-p3-level0 =
				[
					39 00 00 00 00 00 03 F0 5A 5A
					39 00 00 00 00 00 02 B0 05
					39 00 00 00 00 00 02 B1 20
					39 01 00 00 00 00 03 F0 A5 A5
				];
				/*seed crc compenstate 100nit 125~275*/
				qcom,mdss-oled-seed-crc-compensate-p3-level1 =
				[
					39 00 00 00 00 00 03 F0 5A 5A
					39 00 00 00 00 00 02 B0 05
					39 00 00 00 00 00 02 B1 18
					39 01 00 00 00 00 03 F0 A5 A5
				];
				/*seed crc compenstate 20nit 25~125*/
				qcom,mdss-oled-seed-crc-compensate-p3-level2 =
				[
					39 00 00 00 00 00 03 F0 5A 5A
					39 00 00 00 00 00 02 B0 05
					39 00 00 00 00 00 02 B1 15
					39 01 00 00 00 00 03 F0 A5 A5
				];
				/*seed crc compenstate 3nit 0~25*/
				qcom,mdss-oled-seed-crc-compensate-p3-level3 =
				[
					39 00 00 00 00 00 03 F0 5A 5A
					39 00 00 00 00 00 02 B0 05
					39 00 00 00 00 00 02 B1 12
					39 01 00 00 00 00 03 F0 A5 A5
				];
				/*seed crc compenstate default 275~1023*/
				qcom,mdss-oled-seed-crc-compensate-srgb-level0 =
				[
					39 00 00 00 00 00 03 F0 5A 5A
					39 00 00 00 00 00 02 B0 02
					39 00 00 00 00 00 0A B1 A8 03 04 44 C8 12 05 09 B3
					39 01 00 00 00 00 03 F0 A5 A5
				];
				/*seed crc compenstate 100nit 125~275*/
				qcom,mdss-oled-seed-crc-compensate-srgb-level1 =
				[
					39 00 00 00 00 00 03 F0 5A 5A
					39 00 00 00 00 00 02 B0 02
					39 00 00 00 00 00 0A B1 A8 02 04 3B C8 0E 03 08 B8
					39 01 00 00 00 00 03 F0 A5 A5
				];
				/*seed crc compenstate 20nit 25~125*/
				qcom,mdss-oled-seed-crc-compensate-srgb-level2 =
				[
					39 00 00 00 00 00 03 F0 5A 5A
					39 00 00 00 00 00 02 B0 02
					39 00 00 00 00 00 0A B1 A8 01 03 37 C8 0D 03 08 C5
					39 01 00 00 00 00 03 F0 A5 A5
				];
				/*seed crc compenstate 3nit 0~25*/
				qcom,mdss-oled-seed-crc-compensate-srgb-level3 =
				[
					39 00 00 00 00 00 03 F0 5A 5A
					39 00 00 00 00 00 02 B0 02
					39 00 00 00 00 00 0A B1 A8 01 03 35 C8 0C 02 07 CF
					39 01 00 00 00 00 03 F0 A5 A5
				];

				/* samsung OLED HBM mode */
				qcom,mdss-oled-hbm-on-command-level1 =
				[
					39 01 00 00 00 00 03 F0 5A 5A
					39 01 00 00 00 00 02 B0 07
					39 01 00 00 00 00 02 B7 28
					39 01 00 00 00 00 03 F0 A5 A5
					39 01 00 00 11 00 02 53 28
					39 01 00 00 00 00 02 53 E8
					39 01 00 00 00 00 03 51 00 D8
				];

				qcom,mdss-oled-hbm-on-command-level2 =
				[
					39 01 00 00 00 00 03 F0 5A 5A
					39 01 00 00 00 00 02 B0 07
					39 01 00 00 00 00 02 B7 28
					39 01 00 00 00 00 03 F0 A5 A5
					39 01 00 00 11 00 02 53 28
					39 01 00 00 00 00 02 53 E8
					/* 580nit */
					39 01 00 00 00 00 03 51 01 68
				];

				qcom,mdss-oled-hbm-on-command-ud-fingerprint =
				[
					39 00 00 00 00 00 03 F0 5A 5A
					39 00 00 00 00 00 04 B7 00 01 5B
					39 00 00 00 00 00 03 F0 A5 A5
					39 00 00 00 00 00 02 53 E0
					39 01 00 00 00 00 03 51 03 FF
				];

				qcom,mdss-oled-ps-off-command =
				[
					39 00 00 00 00 00 03 F0 5A 5A
					39 00 00 00 00 00 03 BD 00 00
					39 00 00 00 00 00 04 B7 00 01 53
					39 01 00 00 00 00 03 F0 A5 A5

				];

				qcom,mdss-oled-ps-on-command =
				[
					39 00 00 00 00 00 03 F0 5A 5A
					39 00 00 00 00 00 03 BD 00 02
					39 01 00 00 00 00 03 F0 A5 A5
				];

				qcom,mdss-oled-hbm-off-command =
				[
					39 01 00 00 00 00 02 53 28
				];

				/* In sdm710, ps on and ud hbm off command in one sequence */
				qcom,mdss-oled-hbm-off-command-ud-fingerprint =
				[
					/* ps on command */
					39 00 00 00 00 00 03 F0 5A 5A
					39 00 00 00 00 00 03 BD 00 02
					39 00 00 00 00 00 03 F0 A5 A5
					/* hbm off command */
					39 01 00 00 00 00 02 53 20
				];

				qcom,mdss-oled-acl-on-command-level1 =
				[
					39 01 00 00 00 00 02 55 01
				];

				qcom,mdss-oled-acl-on-command-level2 =
				[
					39 01 00 00 00 00 02 55 02
				];

				qcom,mdss-oled-acl-on-command-level3 =
				[
					39 01 00 00 00 00 02 55 03
				];

				qcom,mdss-oled-acl-off-command =
				[
					39 01 00 00 00 00 02 55 00
				];

				qcom,mdss-oled-dimming-speed =
				[
					39 01 00 00 00 00 03 F0 5A 5A
					39 01 00 00 00 00 02 B0 07
					39 01 00 00 00 00 02 B7 28
					39 01 00 00 00 00 03 F0 A5 A5
					39 01 00 00 00 00 02 53 28
				];

				qcom,mdss-oled-dimming-speed-off =
				[
					39 01 00 00 00 00 02 53 20
				];

				/* samsung OLED AOD mode, defaut mode  HLPM high brightness */
				qcom,mdss-oled-aod-on-command =
				[
					39 01 00 00 00 00 03 9F A5 A5
					39 01 00 00 11 00 02 28 00
					39 01 00 00 00 00 03 9F 5A 5A

					39 01 00 00 00 00 03 F0 5A 5A
					39 01 00 00 00 00 02 B0 DF
					39 01 00 00 00 00 05 B8 02 C1 00 5D
					39 01 00 00 00 00 03 F0 A5 A5

					39 01 00 00 00 00 03 9F A5 A5
					39 01 00 00 00 00 02 13 00
					39 01 00 00 00 00 03 9F 5A 5A
				];

				qcom,mdss-oled-alpm-hbirghtness-on-command =
				[
					39 01 00 00 00 00 03 F0 5A 5A
					39 01 00 00 00 00 02 B0 DF
					39 01 00 00 00 00 05 B8 02 C1 00 5D
					39 01 00 00 00 00 02 B0 69
					39 01 00 00 00 00 06 B9 08 08 D0 08 0E
					39 01 00 00 00 00 02 B0 0B
					39 01 00 00 00 00 02 F4 6C
					39 01 00 00 00 00 02 53 22
					39 01 00 00 00 00 02 B0 A5
					39 01 00 00 00 00 02 C7 01
					39 01 00 00 00 00 03 F0 A5 A5

					39 01 00 00 00 00 03 9F A5 A5
					39 01 00 00 00 00 02 29 00
					39 01 00 00 00 00 03 9F 5A 5A
				];

				qcom,mdss-oled-alpm-lbirghtness-on-command =
				[
					39 01 00 00 00 00 03 F0 5A 5A
					39 01 00 00 00 00 02 B0 DF
					39 01 00 00 00 00 05 B8 02 C1 00 5D
					39 01 00 00 00 00 02 B0 69
					39 01 00 00 00 00 06 B9 08 08 D0 08 0E
					39 01 00 00 00 00 02 B0 0B
					39 01 00 00 00 00 02 F4 6C
					39 01 00 00 00 00 02 53 23
					39 01 00 00 00 00 02 B0 A5
					39 01 00 00 00 00 02 C7 01
					39 01 00 00 00 00 03 F0 A5 A5

					39 01 00 00 00 00 03 9F A5 A5
					39 01 00 00 00 00 02 29 00
					39 01 00 00 00 00 03 9F 5A 5A
				];

				qcom,mdss-oled-hlpm-hbirghtness-on-command =
				[
					39 01 00 00 00 00 03 F0 5A 5A
					39 01 00 00 00 00 02 B0 DF
					39 01 00 00 00 00 05 B8 02 C1 00 5D
					39 01 00 00 00 00 02 B0 69
					39 01 00 00 00 00 06 B9 08 08 D0 08 0E
					39 01 00 00 00 00 02 B0 0B
					39 01 00 00 00 00 02 F4 6C
					39 01 00 00 00 00 02 53 22
					39 01 00 00 00 00 02 B0 A5
					39 01 00 00 00 00 02 C7 00
					39 01 00 00 00 00 03 F0 A5 A5

					39 01 00 00 00 00 03 9F A5 A5
					39 01 00 00 00 00 02 29 00
					39 01 00 00 00 00 03 9F 5A 5A
				];

				qcom,mdss-oled-hlpm-lbirghtness-on-command =
				[
					39 01 00 00 00 00 03 F0 5A 5A
					39 01 00 00 00 00 02 B0 DF
					39 01 00 00 00 00 05 B8 02 C1 00 5D
					39 01 00 00 00 00 02 B0 69
					39 01 00 00 00 00 06 B9 08 08 D0 08 0E
					39 01 00 00 00 00 02 B0 0B
					39 01 00 00 00 00 02 F4 6C
					39 01 00 00 00 00 02 53 23
					39 01 00 00 00 00 02 B0 A5
					39 01 00 00 00 00 02 C7 00
					39 01 00 00 00 00 03 F0 A5 A5

					39 01 00 00 00 00 03 9F A5 A5
					39 01 00 00 00 00 02 29 00
					39 01 00 00 00 00 03 9F 5A 5A
				];

				qcom,mdss-oled-aod-off-command =
				[
					39 01 00 00 00 00 03 9F A5 A5
					39 01 00 00 00 00 02 22 00
					39 01 00 00 11 00 02 28 00
					39 01 00 00 00 00 03 9F 5A 5A
					39 01 00 00 00 00 02 53 28
				];

				qcom,mdss-oled-display-on-command =
				[
					39 01 00 00 00 00 02 53 20
					39 01 00 00 00 00 03 9F A5 A5
					39 01 00 00 00 00 02 13 00
					39 01 00 00 00 00 02 29 00
					39 01 00 00 00 00 03 9F 5A 5A
				];

				qcom,mdss-alpm-command-state = "dsi_lp_mode";
				qcom,mdss-dsi-off-command = [
					39 01 00 00 00 00 03 9F A5 A5
					39 01 00 00 0B 00 02 28 00
					39 01 00 00 00 00 02 10 00
					39 01 00 00 00 00 03 9F 5A 5A
					39 01 00 00 00 00 03 F0 5A 5A
					39 01 00 00 00 00 02 B0 05
					39 01 00 00 00 00 02 F4 01
					39 01 00 00 97 00 03 F0 A5 A5
					];
				//p3/crc compensation seed for dc dimming
				qcom,mdss-oled-p3-crc-seed-dc-dimming-level1-commands = [
					39 01 00 00 00 00 03 F0 5A 5A
					39 01 00 00 00 00 02 81 90
					39 01 00 00 00 00 02 B0 14
					39 01 00 00 00 00 04 B1 FF FA FF
					39 01 00 00 00 00 03 F0 A5 A5
				];
				qcom,mdss-oled-p3-crc-seed-dc-dimming-level2-commands = [
					39 01 00 00 00 00 03 F0 5A 5A
					39 01 00 00 00 00 02 81 90
					39 01 00 00 00 00 02 B0 14
					39 01 00 00 00 00 04 B1 FF FC FF
					39 01 00 00 00 00 03 F0 A5 A5
				];
				qcom,mdss-oled-p3-crc-seed-dc-dimming-level3-commands = [
					39 01 00 00 00 00 03 F0 5A 5A
					39 01 00 00 00 00 02 81 90
					39 01 00 00 00 00 02 B0 14
					39 01 00 00 00 00 04 B1 FF FD FF
					39 01 00 00 00 00 03 F0 A5 A5
				];
				qcom,mdss-oled-p3-crc-seed-dc-dimming-level-state = "dsi_hs_mode";

				//srgb compensation seed for dc dimming
				qcom,mdss-oled-srgb-seed-dc-dimming-level1-commands = [
					39 01 00 00 00 00 03 F0 5A 5A
					39 01 00 00 00 00 02 81 90
					39 01 00 00 00 00 02 B0 14
					39 01 00 00 00 00 04 B1 FF FD DE
					39 01 00 00 00 00 03 F0 A5 A5
				];
				qcom,mdss-oled-srgb-seed-dc-dimming-level2-commands = [
					39 01 00 00 00 00 03 F0 5A 5A
					39 01 00 00 00 00 02 81 90
					39 01 00 00 00 00 02 B0 14
					39 01 00 00 00 00 04 B1 FF FD DD
					39 01 00 00 00 00 03 F0 A5 A5
				];
				qcom,mdss-oled-srgb-seed-dc-dimming-level3-commands = [
					39 01 00 00 00 00 03 F0 5A 5A
					39 01 00 00 00 00 02 81 90
					39 01 00 00 00 00 02 B0 14
					39 01 00 00 00 00 04 B1 FF FE DE
					39 01 00 00 00 00 03 F0 A5 A5
				];
		qcom,mdss-oled-srgb-seed-dc-dimming-level-state = "dsi_hs_mode";
		qcom,mdss-oled-seed-crc-compensate-command-state = "dsi_hs_mode";
		qcom,mdss-dsi-on-command-state = "dsi_lp_mode";
		qcom,mdss-dsi-off-command-state = "dsi_lp_mode";
		qcom,mdss-dsi-h-sync-pulse = <0>;
		};
		};
	};
};
