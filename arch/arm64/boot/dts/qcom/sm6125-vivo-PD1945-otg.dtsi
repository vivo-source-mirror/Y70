/* otg relative config for type-C method*/

&usb0 {
    qcom,typec_switch_mode;
};

&qusb_phy0 {
	qcom,qusb-phy-init-seq = <0xc8 0x80
				0x13 0x84
				0x83 0x88
				0xc7 0x8c
				0x30 0x08
				0x79 0x0c
				0x21 0x10
				0x14 0x9c
				0x80 0x04
				0x9f 0x1c
				0x00 0x18>;

	qcom,qusb-phy-host-init-seq = <0xc8 0x80
				0x93 0x84
				0x83 0x88
				0xc7 0x8c
				0x30 0x08
				0x79 0x0c
				0x21 0x10
				0x14 0x9c
				0x80 0x04
				0x9f 0x1c
				0x00 0x18>;

	qcom,tune2-efuse-correction = <(-10)>;
	qcom,tune2-efuse-host-correction = <(-3)>;
};
