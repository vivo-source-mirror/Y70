/* Copyright (c) 2019, The Linux Foundation. All rights reserved.
 *
 * This program is free software; you can redistribute it and/or modify
 * it under the terms of the GNU General Public License version 2 and
 * only version 2 as published by the Free Software Foundation.
 *
 * This program is distributed in the hope that it will be useful,
 * but WITHOUT ANY WARRANTY; without even the implied warranty of
 * MERCHANTABILITY or FITNESS FOR A PARTICULAR PURPOSE.  See the
 * GNU General Public License for more details.
 */

&mdss_mdp {
	dsi_pd1965_lianchuan_nt36672a_fhdplus_video: qcom,mdss_dsi_pd1965_lianchuan_nt36672a_fhdplus_video {
		qcom,mdss-dsi-panel-name = "dsi_pd1965_lianchuan_nt36672a_fhdplus_video panel";
		qcom,mdss-dsi-project-name = "pd1965";
		qcom,mdss-dsi-panel-type = "dsi_video_mode";
		qcom,mdss-dsi-virtual-channel-id = <0>;
		qcom,mdss-dsi-stream = <0>;
		qcom,mdss-dsi-bpp = <24>;
		qcom,mdss-dsi-underflow-color = <0xff>;
		qcom,mdss-dsi-border-color = <0>;
		qcom,mdss-dsi-reset-sequence = <1 5>, <0 5>, <1 12>;
		qcom,mdss-pan-physical-width-dimension = <69>;
		qcom,mdss-pan-physical-height-dimension = <151>;
		qcom,mdss-dsi-traffic-mode = "burst_mode";
		qcom,mdss-dsi-bllp-eof-power-mode;
		qcom,mdss-dsi-bllp-power-mode;
		qcom,mdss-dsi-lane-0-state;
		qcom,mdss-dsi-lane-1-state;
		qcom,mdss-dsi-lane-2-state;
		qcom,mdss-dsi-lane-3-state;
		qcom,mdss-dsi-dma-trigger = "trigger_sw";
		qcom,mdss-dsi-mdp-trigger = "none";
		qcom,mdss-dsi-panel-id = <0x53>;
		qcom,mdss-dsi-lp11-init;
		qcom,vivo-dsi-panel-type = "tft";
		qcom,mdss-panel-sre;
		qcom,mdss-dsi-lcm-sre-max-level = <0xF0>;

		qcom,mdss-dsi-display-timings {
			timing@0{
				qcom,mdss-dsi-panel-width = <1080>;
				qcom,mdss-dsi-panel-height = <2340>;
				qcom,mdss-dsi-h-front-porch = <100>;
				qcom,mdss-dsi-h-back-porch = <80>;
				qcom,mdss-dsi-h-pulse-width = <63>;
				qcom,mdss-dsi-h-front-porch-internal = <16>;
				qcom,mdss-dsi-h-back-porch-internal = <25>;
				qcom,mdss-dsi-h-pulse-width-internal = <10>;
				qcom,mdss-dsi-h-sync-skew = <0>;
				qcom,mdss-dsi-h-sync-pulse = <0>;
				qcom,mdss-dsi-v-back-porch = <25>;
				qcom,mdss-dsi-v-front-porch = <16>;
				qcom,mdss-dsi-v-pulse-width = <10>;
				qcom,mdss-dsi-panel-framerate = <60>;
				qcom,mdss-dsi-h-left-border = <0>;
				qcom,mdss-dsi-h-right-border = <0>;
				qcom,mdss-dsi-v-top-border = <0>;
				qcom,mdss-dsi-v-bottom-border = <0>;
				qcom,mdss-dsi-on-command =
				[
					/* 3-Gam setting */
					39 01 00 00 00 00 02 FF 20
					39 01 00 00 00 00 02 FB 01
					39 01 00 00 00 00 11 B0 00 61 00 71 00 8B 00 A4 00 B8 00 C9 00 D9 00 E8
					39 01 00 00 00 00 11 B1 00 F6 01 24 01 49 01 86 01 B2 01 F8 02 32 02 33
					39 01 00 00 00 00 11 B2 02 6A 02 A8 02 CE 03 03 03 24 03 4C 03 59 03 68
					39 01 00 00 00 00 0F B3 03 79 03 8D 03 AB 03 C5 03 D2 03 D4 00 00
					39 01 00 00 00 00 11 B4 00 65 00 74 00 8F 00 A6 00 BB 00 CE 00 DF 00 EE
					39 01 00 00 00 00 11 B5 00 FC 01 2B 01 50 01 88 01 B5 01 FA 02 33 02 35
					39 01 00 00 00 00 11 B6 02 6C 02 AA 02 D1 03 06 03 27 03 51 03 5E 03 6C
					39 01 00 00 00 00 0F B7 03 7E 03 93 03 A3 03 BB 03 D2 03 D4 00 00
					39 01 00 00 00 00 11 B8 00 00 00 23 00 56 00 7A 00 97 00 AF 00 C4 00 DA
					39 01 00 00 00 00 11 B9 00 EA 01 20 01 48 01 86 01 B4 01 FB 02 34 02 35
					39 01 00 00 00 00 11 BA 02 6D 02 AB 02 D2 03 08 03 2B 03 55 03 5C 03 6F
					39 01 00 00 00 00 0F BB 03 83 03 9C 03 B4 03 CA 03 D2 03 D4 00 00

					39 01 00 00 00 00 02 FF 21
					39 01 00 00 00 00 02 FB 01
					39 01 00 00 00 00 11 B0 00 59 00 69 00 83 00 9C 00 B0 00 C1 00 D1 00 E0
					39 01 00 00 00 00 11 B1 00 EE 01 1C 01 41 01 7E 01 AA 01 F0 02 2A 02 2B
					39 01 00 00 00 00 11 B2 02 62 02 A0 02 C6 02 FB 03 1C 03 44 03 51 03 60
					39 01 00 00 00 00 0F B3 03 71 03 85 03 A3 03 BD 03 D2 03 D4 00 00
					39 01 00 00 00 00 11 B4 00 5D 00 6C 00 87 00 9E 00 B3 00 C6 00 D7 00 E6
					39 01 00 00 00 00 11 B5 00 F4 01 23 01 48 01 80 01 AD 01 F2 02 2B 02 2D
					39 01 00 00 00 00 11 B6 02 64 02 A2 02 C9 02 FE 03 1F 03 49 03 56 03 64
					39 01 00 00 00 00 0F B7 03 76 03 8B 03 9A 03 B4 03 D2 03 D4 00 00
					39 01 00 00 00 00 11 B8 00 00 00 1B 00 4E 00 72 00 8F 00 A7 00 BC 00 D2
					39 01 00 00 00 00 11 B9 00 E2 01 18 01 40 01 7E 01 AC 01 F3 02 2C 02 2D
					39 01 00 00 00 00 11 BA 02 65 02 A3 02 CA 03 00 03 23 03 4D 03 54 03 67
					39 01 00 00 00 00 0F BB 03 7B 03 94 03 AC 03 C2 03 D2 03 D4 00 00
					/* sre setting */
					39 01 00 00 00 00 02 FF 22
					39 01 00 00 00 00 02 FB 01
					39 01 00 00 00 00 02 54 00
					39 01 00 00 00 00 02 53 00
					39 01 00 00 00 00 02 17 00
					39 01 00 00 00 00 02 B8 00
					39 01 00 00 00 00 02 BC 1F
					39 01 00 00 00 00 02 BD 1F
					39 01 00 00 00 00 02 BE 1F
					39 01 00 00 00 00 02 EC 39
					39 01 00 00 00 00 02 C8 0B
					39 01 00 00 00 00 02 CA 77
					39 01 00 00 00 00 02 FF 10
					39 01 00 00 00 00 02 55 40

					39 01 00 00 00 00 02 FF 25
					39 01 00 00 00 00 02 FB 01
					39 01 00 00 00 00 02 05 04
					39 01 00 00 00 00 02 FF 10
					39 01 00 00 00 00 02 FB 01
					39 01 00 00 00 00 03 51 00 00
					39 01 00 00 00 00 02 53 24
					39 01 00 00 00 00 02 55 00

					39 01 00 00 00 00 02 FF 23
					39 01 00 00 00 00 02 FB 01
					39 01 00 00 00 00 02 00 80
					39 01 00 00 00 00 02 04 05
					39 01 00 00 00 00 02 05 2d
					39 01 00 00 00 00 02 06 01
					39 01 00 00 00 00 02 07 00
					39 01 00 00 00 00 02 08 01
					39 01 00 00 00 00 02 09 00

					39 01 00 00 00 00 02 11 01
					39 01 00 00 00 00 02 12 8A
					39 01 00 00 00 00 02 15 6A
					39 01 00 00 00 00 02 16 0B

					39 01 00 00 00 00 02 30 FF
					39 01 00 00 00 00 02 31 F0
					39 01 00 00 00 00 02 32 EB
					39 01 00 00 00 00 02 33 E5
					39 01 00 00 00 00 02 34 DD
					39 01 00 00 00 00 02 35 DA
					39 01 00 00 00 00 02 36 D5
					39 01 00 00 00 00 02 37 D0
					39 01 00 00 00 00 02 38 CE
					39 01 00 00 00 00 02 39 CD
					39 01 00 00 00 00 02 3A CD
					39 01 00 00 00 00 02 3B CD
					39 01 00 00 00 00 02 3D CB
					39 01 00 00 00 00 02 3F CB
					39 01 00 00 00 00 02 40 C6
					39 01 00 00 00 00 02 41 BF

					39 01 00 00 00 00 02 45 FF
					39 01 00 00 00 00 02 46 F0
					39 01 00 00 00 00 02 47 E8
					39 01 00 00 00 00 02 48 CE
					39 01 00 00 00 00 02 49 BC
					39 01 00 00 00 00 02 4A B8
					39 01 00 00 00 00 02 4B B5
					39 01 00 00 00 00 02 4C B0
					39 01 00 00 00 00 02 4D A8
					39 01 00 00 00 00 02 4E A0
					39 01 00 00 00 00 02 4F 9B
					39 01 00 00 00 00 02 50 98
					39 01 00 00 00 00 02 51 98
					39 01 00 00 00 00 02 52 88
					39 01 00 00 00 00 02 53 80
					39 01 00 00 00 00 02 54 7F

					39 01 00 00 00 00 02 58 FF
					39 01 00 00 00 00 02 59 F6
					39 01 00 00 00 00 02 5A ED
					39 01 00 00 00 00 02 5B E6
					39 01 00 00 00 00 02 5C DF
					39 01 00 00 00 00 02 5D D8
					39 01 00 00 00 00 02 5E D3
					39 01 00 00 00 00 02 5F CE
					39 01 00 00 00 00 02 60 C9
					39 01 00 00 00 00 02 61 C4
					39 01 00 00 00 00 02 62 C1
					39 01 00 00 00 00 02 63 BE
					39 01 00 00 00 00 02 64 BB
					39 01 00 00 00 00 02 65 B8
					39 01 00 00 00 00 02 66 B6
					39 01 00 00 00 00 02 67 B5
					39 01 00 00 00 00 02 FF 10
					39 01 00 00 00 00 02 FB 01
					39 01 00 00 00 00 03 68 03 01

					39 01 00 00 78 00 01 11
					39 01 00 00 14 00 01 29
				];

				qcom,mdss-oled-acl-off-command = [
					39 01 00 00 00 00 02 53 2C
					39 01 00 00 00 00 02 55 00
				];

				qcom,mdss-oled-acl-on-command-level1 = [
					39 01 00 00 00 00 02 53 2C
					39 01 00 00 00 00 02 55 01
				];

				qcom,mdss-oled-acl-on-command-level2 = [
					39 01 00 00 00 00 02 53 2C
					39 01 00 00 00 00 02 55 02
				];

				qcom,mdss-oled-acl-on-command-level3 = [
					39 01 00 00 00 00 02 53 2C
					39 01 00 00 00 00 02 55 02
				];

				qcom,mdss-lcm-sre-off-command = [
					39 01 00 00 00 00 02 55 00
				];

				qcom,mdss-lcm-sre-level1-command = [
					39 01 00 00 00 00 02 55 40
				];

				qcom,mdss-lcm-sre-level2-command = [
					39 01 00 00 00 00 02 55 60
				];

				qcom,mdss-dsi-off-command = [
					39 01 00 00 14 00 02 28 00
					39 01 00 00 78 00 02 10 00
				];

				qcom,mdss-dsi-on-command-state = "dsi_lp_mode";
				qcom,mdss-dsi-off-command-state = "dsi_lp_mode";
				qcom,mdss-alpm-command-state = "dsi_hs_mode";
			};
		};
	};
};
