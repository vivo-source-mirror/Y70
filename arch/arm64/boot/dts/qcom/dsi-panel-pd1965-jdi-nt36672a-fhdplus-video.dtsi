/* Copyright (c) 2019, The Linux Foundation. All rights reserved.
 *
 * This program is free software; you can redistribute it and/or modify
 * it under the terms of the GNU General Public License version 2 and
 * only version 2 as published by the Free Software Foundation.
 *
 * This program is distributed in the hope that it will be useful,
 * but WITHOUT ANY WARRANTY; without even the implied warranty of
 * MERCHANTABILITY or FITNESS FOR A PARTICULAR PURPOSE.  See the
 * GNU General Public License for more details.
 */

&mdss_mdp {
	dsi_pd1965_jdi_nt36672a_fhdplus_video: qcom,mdss_dsi_pd1965_jdi_nt36672a_fhdplus_video {
		qcom,mdss-dsi-panel-name = "dsi_pd1965_jdi_nt36672a_fhdplus_video panel";
		qcom,mdss-dsi-project-name = "pd1965";
		qcom,mdss-dsi-panel-type = "dsi_video_mode";
		qcom,mdss-dsi-virtual-channel-id = <0>;
		qcom,mdss-dsi-stream = <0>;
		qcom,mdss-dsi-bpp = <24>;
		qcom,mdss-dsi-underflow-color = <0xff>;
		qcom,mdss-dsi-border-color = <0>;
		qcom,mdss-dsi-reset-sequence = <1 10>, <0 10>, <1 12>;
		qcom,mdss-pan-physical-width-dimension = <69>;
		qcom,mdss-pan-physical-height-dimension = <151>;
		qcom,mdss-dsi-traffic-mode = "non_burst_sync_event";
		qcom,mdss-dsi-bllp-eof-power-mode;
		qcom,mdss-dsi-bllp-power-mode;
		qcom,mdss-dsi-lane-0-state;
		qcom,mdss-dsi-lane-1-state;
		qcom,mdss-dsi-lane-2-state;
		qcom,mdss-dsi-lane-3-state;
		qcom,mdss-dsi-dma-trigger = "trigger_sw";
		qcom,mdss-dsi-mdp-trigger = "none";
		qcom,mdss-dsi-panel-id = <0x41>;
		qcom,mdss-dsi-lp11-init;
		qcom,vivo-dsi-panel-type = "tft";
		qcom,mdss-panel-sre;
		qcom,mdss-dsi-lcm-sre-max-level = <0xF0>;

		qcom,mdss-dsi-display-timings {
			timing@0{
				qcom,mdss-dsi-panel-width = <1080>;
				qcom,mdss-dsi-panel-height = <2340>;
				qcom,mdss-dsi-h-front-porch = <100>;
				qcom,mdss-dsi-h-back-porch = <80>;
				qcom,mdss-dsi-h-pulse-width = <64>;
				qcom,mdss-dsi-h-front-porch-internal = <16>;
				qcom,mdss-dsi-h-back-porch-internal = <26>;
				qcom,mdss-dsi-h-pulse-width-internal = <16>;
				qcom,mdss-dsi-h-sync-skew = <0>;
				qcom,mdss-dsi-h-sync-pulse = <0>;
				qcom,mdss-dsi-v-back-porch = <13>;
				qcom,mdss-dsi-v-front-porch = <32>;
				qcom,mdss-dsi-v-pulse-width = <4>;
				qcom,mdss-dsi-panel-framerate = <60>;
				qcom,mdss-dsi-h-left-border = <0>;
				qcom,mdss-dsi-h-right-border = <0>;
				qcom,mdss-dsi-v-top-border = <0>;
				qcom,mdss-dsi-v-bottom-border = <0>;
				qcom,mdss-dsi-on-command =
				[
					39 01 00 00 00 00 02 FF 20
					39 01 00 00 00 00 02 FB 01
					//GVDDP/N Default 5V
					//VGH=8.7V
					39 01 00 00 00 00 02 06 9B
					//VGL=-8.3V
					39 01 00 00 00 00 02 07 A1
					//VGHO=8.2V
					39 01 00 00 00 00 02 0E AD
					//VGLO=-7.8V
					39 01 00 00 00 00 02 0F AC
					39 01 00 00 00 00 02 62 AB
					39 01 00 00 00 00 02 6D 44
					39 01 00 00 00 00 02 FF 24
					39 01 00 00 00 00 02 FB 01
					39 01 00 00 00 00 02 00 1C
					39 01 00 00 00 00 02 01 0D
					39 01 00 00 00 00 02 02 1C
					39 01 00 00 00 00 02 03 0A
					39 01 00 00 00 00 02 04 1C
					39 01 00 00 00 00 02 05 23
					39 01 00 00 00 00 02 06 1C
					39 01 00 00 00 00 02 07 1C
					39 01 00 00 00 00 02 08 06
					39 01 00 00 00 00 02 09 05
					39 01 00 00 00 00 02 0A 04
					39 01 00 00 00 00 02 0B 03
					39 01 00 00 00 00 02 0C 1C
					39 01 00 00 00 00 02 0D 1C
					39 01 00 00 00 00 02 0E 1C
					39 01 00 00 00 00 02 0F 1C
					39 01 00 00 00 00 02 10 1C
					39 01 00 00 00 00 02 11 14
					39 01 00 00 00 00 02 12 10
					39 01 00 00 00 00 02 13 12
					39 01 00 00 00 00 02 14 1C
					39 01 00 00 00 00 02 15 11
					39 01 00 00 00 00 02 16 13
					39 01 00 00 00 00 02 17 1C
					39 01 00 00 00 00 02 18 1C
					39 01 00 00 00 00 02 19 1C
					39 01 00 00 00 00 02 1A 01
					39 01 00 00 00 00 02 1B 1C
					39 01 00 00 00 00 02 1C 23
					39 01 00 00 00 00 02 1D 1C
					39 01 00 00 00 00 02 1E 1C
					39 01 00 00 00 00 02 1F 06
					39 01 00 00 00 00 02 20 05
					39 01 00 00 00 00 02 21 04
					39 01 00 00 00 00 02 22 03
					39 01 00 00 00 00 02 23 1C
					39 01 00 00 00 00 02 24 1C
					39 01 00 00 00 00 02 25 1C
					39 01 00 00 00 00 02 26 1C
					39 01 00 00 00 00 02 27 1C
					39 01 00 00 00 00 02 28 14
					39 01 00 00 00 00 02 29 10
					39 01 00 00 00 00 02 2A 12
					39 01 00 00 00 00 02 2B 1C
					39 01 00 00 00 00 02 2D 11
					39 01 00 00 00 00 02 2F 13
					39 01 00 00 00 00 02 31 04
					39 01 00 00 00 00 02 32 08
					39 01 00 00 00 00 02 33 00
					39 01 00 00 00 00 02 34 00
					39 01 00 00 00 00 02 35 00
					39 01 00 00 00 00 02 37 24
					39 01 00 00 00 00 02 38 61
					39 01 00 00 00 00 02 39 61
					39 01 00 00 00 00 02 3F 61
					39 01 00 00 00 00 02 41 04
					39 01 00 00 00 00 02 42 08
					39 01 00 00 00 00 02 4C 15
					39 01 00 00 00 00 02 4D 15
					39 01 00 00 00 00 02 60 90
					39 01 00 00 00 00 02 61 24
					39 01 00 00 00 00 02 62 03
					39 01 00 00 00 00 02 6F 90
					39 01 00 00 00 00 02 72 00
					39 01 00 00 00 00 02 73 00
					39 01 00 00 00 00 02 74 00
					39 01 00 00 00 00 02 75 00
					39 01 00 00 00 00 02 79 01
					39 01 00 00 00 00 02 7A 03
					39 01 00 00 00 00 02 7B 9C
					39 01 00 00 00 00 02 7C 80
					39 01 00 00 00 00 02 7D 05
					39 01 00 00 00 00 02 80 42
					39 01 00 00 00 00 02 82 13
					39 01 00 00 00 00 02 83 22
					39 01 00 00 00 00 02 84 31
					39 01 00 00 00 00 02 85 00
					39 01 00 00 00 00 02 86 00
					39 01 00 00 00 00 02 87 00
					39 01 00 00 00 00 02 88 13
					39 01 00 00 00 00 02 89 22
					39 01 00 00 00 00 02 8A 31
					39 01 00 00 00 00 02 8B 00
					39 01 00 00 00 00 02 8C 00
					39 01 00 00 00 00 02 8D 00
					39 01 00 00 00 00 02 8E F4
					39 01 00 00 00 00 02 8F 01
					39 01 00 00 00 00 02 90 80
					39 01 00 00 00 00 02 92 73
					39 01 00 00 00 00 02 93 20
					39 01 00 00 00 00 02 94 11
					39 01 00 00 00 00 02 B3 22
					39 01 00 00 00 00 02 B4 85
					39 01 00 00 00 00 02 B5 54
					39 01 00 00 00 00 02 C2 86
					39 01 00 00 00 00 02 DC 00
					39 01 00 00 00 00 02 DE 10
					39 01 00 00 00 00 02 DF 39
					39 01 00 00 00 00 02 E0 39
					39 01 00 00 00 00 02 EB 03
					39 01 00 00 00 00 02 EF 04
					39 01 00 00 00 00 02 F0 01
					39 01 00 00 00 00 02 F3 40
					39 01 00 00 00 00 02 FF 25
					39 01 00 00 00 00 02 FB 01
					39 01 00 00 00 00 02 21 1C
					39 01 00 00 00 00 02 22 1C
					39 01 00 00 00 00 02 24 73
					39 01 00 00 00 00 02 25 73
					39 01 00 00 00 00 02 68 50
					39 01 00 00 00 00 02 69 10
					39 01 00 00 00 00 02 6B 00
					39 01 00 00 00 00 02 6D 0D
					//C02
					39 01 00 00 00 00 02 6E 48
					39 01 00 00 00 00 02 71 5D
					39 01 00 00 00 00 02 72 31
					39 01 00 00 00 00 02 73 48
					39 01 00 00 00 00 02 74 12
					39 01 00 00 00 00 02 77 70
					39 01 00 00 00 00 02 78 85
					39 01 00 00 00 00 02 7D 00
					39 01 00 00 00 00 02 7E 15
					39 01 00 00 00 00 02 7F 00
					39 01 00 00 00 00 02 84 4D
					39 01 00 00 00 00 02 BC 23
					39 01 00 00 00 00 02 BF C0
					39 01 00 00 00 00 02 D0 80
					39 01 00 00 00 00 02 D9 69
					39 01 00 00 00 00 02 FF 26
					39 01 00 00 00 00 02 FB 01
					39 01 00 00 00 00 02 06 FF
					39 01 00 00 00 00 02 0C 11
					39 01 00 00 00 00 02 0F 09
					39 01 00 00 00 00 02 10 0A
					39 01 00 00 00 00 02 12 82
					39 01 00 00 00 00 02 1A EE
					39 01 00 00 00 00 02 1C AF
					39 01 00 00 00 00 02 1D 0B
					39 01 00 00 00 00 02 1E 71
					39 01 00 00 00 00 02 98 F1
					39 01 00 00 00 00 02 9A 81
					39 01 00 00 00 00 02 9D 00
					39 01 00 00 00 00 02 9E 01
					39 01 00 00 00 00 02 A9 11
					39 01 00 00 00 00 02 AE 42
					39 01 00 00 00 00 02 AF 06
					39 01 00 00 00 00 02 B1 05
					39 01 00 00 00 00 02 B2 2C
					39 01 00 00 00 00 02 B4 AE
					39 01 00 00 00 00 02 FF 27
					39 01 00 00 00 00 02 FB 01
					39 01 00 00 00 00 02 13 00
					39 01 00 00 00 00 02 1E 15
					39 01 00 00 00 00 02 FF F0
					39 01 00 00 00 00 02 FB 01
					39 01 00 00 00 00 02 A2 00

					39 01 00 00 00 00 02 FF 20
					39 01 00 00 00 00 02 FB 01
					39 01 00 00 00 00 11 B0 00 A8 00 B2 00 C3 00 D5 00 E3 00 F3 00 FE 01 0A
					39 01 00 00 00 00 11 B1 01 15 01 3A 01 5B 01 8B 01 B3 01 F4 02 2A 02 2C
					39 01 00 00 00 00 11 B2 02 62 02 A0 02 C9 02 FD 03 1F 03 4A 03 58 03 67
					39 01 00 00 00 00 0F B3 03 7B 03 93 03 AF 03 C8 03 D9 03 DC 00 00
					39 01 00 00 00 00 11 B4 00 00 00 26 00 4E 00 6F 00 8B 00 A2 00 B8 00 CB
					39 01 00 00 00 00 11 B5 00 DC 01 13 01 3B 01 78 01 A6 01 ED 02 26 02 28
					39 01 00 00 00 00 11 B6 02 5E 02 9D 02 C6 02 FA 03 1C 03 47 03 55 03 64
					39 01 00 00 00 00 0F B7 03 78 03 8F 03 9A 03 B5 03 D9 03 DC 00 00
					39 01 00 00 00 00 11 B8 00 8C 00 98 00 AD 00 C1 00 D2 00 E1 00 F0 00 FD
					39 01 00 00 00 00 11 B9 01 09 01 32 01 52 01 85 01 AE 01 F0 02 27 02 29
					39 01 00 00 00 00 11 BA 02 5E 02 9D 02 C7 02 FB 03 1C 03 4E 03 5F 03 6E
					39 01 00 00 00 00 0F BB 03 78 03 9E 03 BA 03 CE 03 DA 03 DC 00 00
					39 01 00 00 00 00 02 FF 21
					39 01 00 00 00 00 02 FB 01
					39 01 00 00 00 00 11 B0 00 A0 00 AA 00 BB 00 CD 00 DB 00 EB 00 F6 01 02
					39 01 00 00 00 00 11 B1 01 0D 01 32 01 53 01 83 01 AB 01 EC 02 22 02 24
					39 01 00 00 00 00 11 B2 02 5A 02 98 02 C1 02 F5 03 17 03 42 03 50 03 5F
					39 01 00 00 00 00 0F B3 03 73 03 8B 03 A7 03 C0 03 D1 03 D4 00 00
					39 01 00 00 00 00 11 B4 00 00 00 1E 00 46 00 67 00 83 00 9A 00 B0 00 C3
					39 01 00 00 00 00 11 B5 00 D4 01 0B 01 33 01 70 01 9E 01 E5 02 1E 02 20
					39 01 00 00 00 00 11 B6 02 56 02 95 02 BE 02 F1 03 12 03 3F 03 4D 03 5C
					39 01 00 00 00 00 0F B7 03 70 03 87 03 92 03 AD 03 D1 03 D4 00 00
					39 01 00 00 00 00 11 B8 00 84 00 90 00 A5 00 B9 00 CA 00 D9 00 E8 00 F5
					39 01 00 00 00 00 11 B9 01 01 01 2A 01 4A 01 7D 01 A6 01 E8 02 1F 02 21
					39 01 00 00 00 00 11 BA 02 56 02 95 02 BF 02 F4 03 16 03 46 03 57 03 66
					39 01 00 00 00 00 0F BB 03 70 03 96 03 B2 03 C6 03 D2 03 D4 00 00

					39 01 00 00 00 00 02 FF 22
					39 01 00 00 00 00 02 FB 01
					39 01 00 00 00 00 02 54 00
					39 01 00 00 00 00 02 53 00
					39 01 00 00 00 00 02 17 00
					39 01 00 00 00 00 02 B8 00
					39 01 00 00 00 00 02 BC 1F
					39 01 00 00 00 00 02 BD 1F
					39 01 00 00 00 00 02 BE 1F
					39 01 00 00 00 00 02 EC 39
					39 01 00 00 00 00 02 C8 0B
					39 01 00 00 00 00 02 CA 77
					39 01 00 00 00 00 02 FF 10
					39 01 00 00 00 00 02 55 40

					39 01 00 00 00 00 02 FF 10

					39 01 00 00 00 00 02 FF 23
					39 01 00 00 00 00 02 FB 01
					39 01 00 00 00 00 02 00 80
					39 01 00 00 00 00 02 04 05
					39 01 00 00 00 00 02 05 2d
					39 01 00 00 00 00 02 06 01
					39 01 00 00 00 00 02 07 00
					39 01 00 00 00 00 02 08 01
					39 01 00 00 00 00 02 09 00

					39 01 00 00 00 00 02 11 01
					39 01 00 00 00 00 02 12 8A
					39 01 00 00 00 00 02 15 6A
					39 01 00 00 00 00 02 16 0B

					39 01 00 00 00 00 02 30 FF
					39 01 00 00 00 00 02 31 F0
					39 01 00 00 00 00 02 32 EB
					39 01 00 00 00 00 02 33 E5
					39 01 00 00 00 00 02 34 DD
					39 01 00 00 00 00 02 35 DA
					39 01 00 00 00 00 02 36 D5
					39 01 00 00 00 00 02 37 D0
					39 01 00 00 00 00 02 38 CE
					39 01 00 00 00 00 02 39 CD
					39 01 00 00 00 00 02 3A CD
					39 01 00 00 00 00 02 3B CD
					39 01 00 00 00 00 02 3D CB
					39 01 00 00 00 00 02 3F CB
					39 01 00 00 00 00 02 40 C6
					39 01 00 00 00 00 02 41 BF

					39 01 00 00 00 00 02 45 FF
					39 01 00 00 00 00 02 46 F0
					39 01 00 00 00 00 02 47 E8
					39 01 00 00 00 00 02 48 CE
					39 01 00 00 00 00 02 49 BC
					39 01 00 00 00 00 02 4A B8
					39 01 00 00 00 00 02 4B B5
					39 01 00 00 00 00 02 4C B0
					39 01 00 00 00 00 02 4D A8
					39 01 00 00 00 00 02 4E A0
					39 01 00 00 00 00 02 4F 9B
					39 01 00 00 00 00 02 50 98
					39 01 00 00 00 00 02 51 98
					39 01 00 00 00 00 02 52 88
					39 01 00 00 00 00 02 53 80
					39 01 00 00 00 00 02 54 7F

					39 01 00 00 00 00 02 58 FF
					39 01 00 00 00 00 02 59 F6
					39 01 00 00 00 00 02 5A ED
					39 01 00 00 00 00 02 5B E6
					39 01 00 00 00 00 02 5C DF
					39 01 00 00 00 00 02 5D D8
					39 01 00 00 00 00 02 5E D3
					39 01 00 00 00 00 02 5F CE
					39 01 00 00 00 00 02 60 C9
					39 01 00 00 00 00 02 61 C4
					39 01 00 00 00 00 02 62 C1
					39 01 00 00 00 00 02 63 BE
					39 01 00 00 00 00 02 64 BB
					39 01 00 00 00 00 02 65 B8
					39 01 00 00 00 00 02 66 B6
					39 01 00 00 00 00 02 67 B5

					39 01 00 00 00 00 02 FF 24
					39 01 00 00 00 00 02 FB 01
					39 01 00 00 00 00 02 11 1C
					39 01 00 00 00 00 02 12 1C
					39 01 00 00 00 00 02 13 1C
					39 01 00 00 00 00 02 15 1C
					39 01 00 00 00 00 02 16 1C
					39 01 00 00 00 00 02 4C 1C
					39 01 00 00 00 00 02 28 14
					39 01 00 00 00 00 02 29 10
					39 01 00 00 00 00 02 2A 12
					39 01 00 00 00 00 02 2D 11
					39 01 00 00 00 00 02 2F 13
					39 01 00 00 00 00 02 4D 15

					39 01 00 00 00 00 02 FF 10
					39 01 00 00 00 00 02 FB 01
					39 01 00 00 00 00 03 68 03 01
					39 01 00 00 00 00 03 51 00 00
					39 01 00 00 00 00 02 53 24
					39 01 00 00 00 00 02 55 00
					
					39 01 00 00 78 00 01 11
					39 01 00 00 14 00 01 29
				];

				qcom,mdss-oled-acl-off-command = [
					39 01 00 00 00 00 02 53 2C
					39 01 00 00 00 00 02 55 00
				];

				qcom,mdss-oled-acl-on-command-level1 = [
					39 01 00 00 00 00 02 53 2C
					39 01 00 00 00 00 02 55 01
				];

				qcom,mdss-oled-acl-on-command-level2 = [
					39 01 00 00 00 00 02 53 2C
					39 01 00 00 00 00 02 55 02
				];

				qcom,mdss-oled-acl-on-command-level3 = [
					39 01 00 00 00 00 02 53 2C
					39 01 00 00 00 00 02 55 02
				];

				qcom,mdss-lcm-sre-off-command = [
					39 01 00 00 00 00 02 55 00
				];

				qcom,mdss-lcm-sre-level1-command = [
					39 01 00 00 00 00 02 55 40
				];

				qcom,mdss-lcm-sre-level2-command = [
					39 01 00 00 00 00 02 55 60
				];

				qcom,mdss-dsi-off-command = [
					39 01 00 00 14 00 02 28 00
					39 01 00 00 78 00 02 10 00
				];

				qcom,mdss-dsi-on-command-state = "dsi_lp_mode";
				qcom,mdss-dsi-off-command-state = "dsi_lp_mode";
				qcom,mdss-alpm-command-state = "dsi_hs_mode";
			};
		};
	};
};
